## prj.conf
```kconfig
CONFIG_GPIO=y
CONFIG_CAN=y
CONFIG_CAN_STM32_FDCAN=y
CONFIG_FLASH=y
CONFIG_FLASH_MAP=y
CONFIG_MPU_ALLOW_FLASH_WRITE=y
CONFIG_SPI=y
CONFIG_SPI_STM32=y
CONFIG_CACHE_MANAGEMENT=y
CONFIG_DMA=n
CONFIG_SPI_STM32_DMA=n

# --- LOGGING & CONSOLE SETUP (RTT) ---
# 1. Force the Console subsystem to stay ON
CONFIG_CONSOLE=y
CONFIG_STDOUT_CONSOLE=y

# 2. Configure RTT as the backend
CONFIG_USE_SEGGER_RTT=n
CONFIG_RTT_CONSOLE=n

# 3. Disable UART/Serial to prevent conflicts
CONFIG_UART_CONSOLE=y
CONFIG_SERIAL=y

# 4. Connect Printk and Logging to RTT
CONFIG_PRINTK=y
CONFIG_LOG=y
CONFIG_LOG_BACKEND_RTT=n
CONFIG_LOG_BACKEND_UART=y
CONFIG_LOG_MODE_IMMEDIATE=y

CONFIG_NEWLIB_LIBC=y
CONFIG_NEWLIB_LIBC_FLOAT_PRINTF=y
```

## src/main.c
```c
/*
 * UT-CORE CDH — Threaded Flight Architecture
 *
 * Hardware: STM32U5 microcontroller, Zephyr RTOS.
 * Bus:      FDCAN1 at 500 kbit/s, 29-bit extended IDs.
 * Sensors:  Up to 6 I2C temperature sensors (TMP1xx-family, 0x48-0x4D).
 *
 * Thread overview (highest to lowest priority):
 *   PRIO 0  watchdog_thread     — kicks hardware watchdog; must never starve
 *   PRIO 1  can_rx_thread       — drains hardware FIFO into SW queue
 *   PRIO 2  can_process_thread  — decodes & dispatches frames
 *   PRIO 3  scheduler_thread    — heartbeat + future mission scheduling
 *   PRIO 4  gnss_thread         — requests & stores GNSS position data
 *   PRIO 5  soh_thread          — reads temps & checks node-alive timeouts
 *   PRIO 6  telemetry_thread    — assembles & downlinks telemetry packets
 *
 * LED usage:
 *   led0 — pulses briefly on every received CAN frame (activity indicator)
 *   led1 — spare
 *   led2 — controlled remotely via OP_SET_LED ground command
 */

#include <zephyr/kernel.h>
#include <zephyr/sys/printk.h>
#include <zephyr/logging/log.h>
#include <stm32u5xx.h>
#include <stdbool.h>
#include <string.h>

#include "board_config.h"
#include "../../../common/can_proto.h"
#include "../../../common/temp_telemetry.h"

LOG_MODULE_REGISTER(cdh, LOG_LEVEL_INF);

/* ================= DEVICE HANDLES ================= */

static const struct device          *can_dev  = DEVICE_DT_GET(CAN_NODE);
static const struct device          *gpioa    = DEVICE_DT_GET(GPIOA_NODE);
static const struct device          *i2c_bus  = DEVICE_DT_GET(I2C_BUS_NODE);
static const struct gpio_dt_spec     led0     = GPIO_DT_SPEC_GET(LED0_NODE, gpios);
static const struct gpio_dt_spec     led1     = GPIO_DT_SPEC_GET(LED1_NODE, gpios);
static const struct gpio_dt_spec     led2     = GPIO_DT_SPEC_GET(LED2_NODE, gpios);

/* Hardware-backed CAN RX queue — the driver ISR deposits frames here. */
CAN_MSGQ_DEFINE(rxq, 16);

/* SW queue between can_rx_thread and can_process_thread. */
K_MSGQ_DEFINE(can_proc_q, sizeof(struct can_frame), CAN_PROC_Q_LEN, 4);

/* ================= DATA STRUCTURES ================= */

/*
 * node_status_t — liveness record for one remote satellite subsystem.
 * Written by handle_heartbeat(), read by check_node_timeouts().
 */
typedef struct {
    bool    alive;
    int64_t last_seen_ms;
} node_status_t;

typedef struct {
    node_status_t cdh;
    node_status_t eps;
    node_status_t comms;
    node_status_t adcs;
    node_status_t motor;
    node_status_t gnss;
    node_status_t star;
    node_status_t solar;
} node_heartbeat_t;

static node_heartbeat_t node_alive = {0};

/*
 * can_packet_t — decoded CAN frame with routing fields unpacked from the ID.
 *
 * 29-bit ID layout (see can_proto.h):
 *   [28:26] priority | [21:14] src | [13:6] dst | [5:0] msg_class
 */
typedef struct {
    uint8_t  priority;
    uint8_t  msg_class;
    uint8_t  src;
    uint8_t  dst;
    uint16_t inst;
    uint8_t  data[8];
    uint8_t  dlc;
} can_packet_t;

/*
 * gnss_data_t — latest position fix received from the GNSS node.
 *
 * TODO: populate fields once the GNSS CAN telemetry format is defined.
 */
typedef struct {
    int32_t  lat_deg_e7;
    int32_t  lon_deg_e7;
    int32_t  alt_mm;
    uint32_t timestamp_ms;
    bool     valid;
} gnss_data_t;

static gnss_data_t gnss_latest = {0};

typedef struct {
    bool valid;
    int8_t temp_c[NUM_TEMP_SENSORS]; /* 0x48..0x4D, signed degC, -128 on error */
} cdh_temp_snapshot_t;

static cdh_temp_snapshot_t cdh_temp_latest = {0};
K_MUTEX_DEFINE(cdh_temp_lock);

/* ================= MODE STATE MACHINE ================= */

typedef enum {
    MODE_SETUP,
    MODE_STANDARD,
    MODE_MISSION,
    MODE_ERROR
} cdh_mode_t;

volatile cdh_mode_t current_mode = MODE_SETUP;

/* ================= THREAD STACKS ================= */

K_THREAD_STACK_DEFINE(watchdog_stack,  STACK_SIZE);
K_THREAD_STACK_DEFINE(can_stack,       STACK_SIZE);
K_THREAD_STACK_DEFINE(sched_stack,     STACK_SIZE);
K_THREAD_STACK_DEFINE(soh_stack,       STACK_SIZE);
K_THREAD_STACK_DEFINE(can_proc_stack,  STACK_SIZE);
K_THREAD_STACK_DEFINE(gnss_stack,      STACK_SIZE);
K_THREAD_STACK_DEFINE(telemetry_stack, STACK_SIZE);

static struct k_thread watchdog_thread_data;
static struct k_thread can_thread_data;
static struct k_thread sched_thread_data;
static struct k_thread soh_thread_data;
static struct k_thread can_proc_thread_data;
static struct k_thread gnss_thread_data;
static struct k_thread telemetry_thread_data;

/* ================= FORWARD DECLARATIONS ================= */

static void handle_heartbeat(const can_packet_t *pkt);
static void handle_command(const can_packet_t *pkt);
static void handle_cmd_response(const can_packet_t *pkt);
static void handle_telemetry(const can_packet_t *pkt);
static void handle_health(const can_packet_t *pkt);
static void can_dispatch(const can_packet_t *pkt);
static int8_t q4_to_int8_c(int16_t t_q4);
static void send_cdh_temp_telemetry(void);

/* ===================================================== */
/* ================= UTILITY FUNCTIONS ================== */
/* ===================================================== */

static void read_uid(uint32_t uid[3])
{
    LOG_INF("reading UID...");
    uid[0] = *(uint32_t *)(UID_BASE + 0x0);
    uid[1] = *(uint32_t *)(UID_BASE + 0x4);
    uid[2] = *(uint32_t *)(UID_BASE + 0x8);
}

static inline void led_can_activity(void)
{
    gpio_pin_set_dt(&led0, 1);
    k_busy_wait(1000);
    gpio_pin_set_dt(&led0, 0);
}

static void leds_init(void)
{
    gpio_pin_configure_dt(&led0, GPIO_OUTPUT_INACTIVE);
    gpio_pin_configure_dt(&led1, GPIO_OUTPUT_INACTIVE);
    gpio_pin_configure_dt(&led2, GPIO_OUTPUT_INACTIVE);
}

static node_status_t *get_node_status(uint8_t node_id)
{
    switch (node_id) {
        case CDH_ID:   return &node_alive.cdh;
        case EPS_ID:   return &node_alive.eps;
        case COMMS_ID: return &node_alive.comms;
        case ADCS_ID:  return &node_alive.adcs;
        case MOTOR_ID: return &node_alive.motor;
        case GNSS_ID:  return &node_alive.gnss;
        case STAR_ID:  return &node_alive.star;
        case SOLAR_ID: return &node_alive.solar;
        default:       return NULL;
    }
}

/* ===================================================== */
/* ================= CAN FUNCTIONS ====================== */
/* ===================================================== */

static void send_simple(uint8_t dst, uint8_t cls, uint8_t op, uint8_t val)
{
    struct can_frame f = {0};
    f.id    = CAN_ID_FULL(PRIO_LOW, NODE_ID, dst, cls);
    f.flags = CAN_FRAME_IDE;
    can_fill_payload(&f, NODE_ID, op, val, 0, 0, 0, 0, 0);
    can_send(can_dev, &f, K_NO_WAIT, NULL, NULL);
}

static void tcan3403_wakeup(void)
{
    gpio_pin_configure(gpioa, PIN_SHDN,   GPIO_OUTPUT_INACTIVE);
    gpio_pin_configure(gpioa, PIN_SILENT, GPIO_OUTPUT_INACTIVE);
    k_msleep(1);
    LOG_INF("TCAN3403 Awake");
}

static void can_setup(void)
{
    if (!device_is_ready(can_dev)) {
        LOG_ERR("CAN not ready");
        return;
    }

    can_set_bitrate(can_dev, 500000);
    can_set_mode(can_dev, CAN_MODE_NORMAL);
    can_start(can_dev);

    const struct can_filter to_me = {
        .id    = CAN_DST(DST_ME),
        .mask  = CAN_DST_MASK_29,
        .flags = CAN_FILTER_IDE
    };

    const struct can_filter bcast = {
        .id    = CAN_DST(CAN_BROADCAST),
        .mask  = CAN_DST_MASK_29,
        .flags = CAN_FILTER_IDE
    };

    can_add_rx_filter_msgq(can_dev, &rxq, &to_me);
    can_add_rx_filter_msgq(can_dev, &rxq, &bcast);

    LOG_INF("Filter to_me:  id=0x%08X mask=0x%08X", to_me.id, to_me.mask);
    LOG_INF("Filter bcast:  id=0x%08X mask=0x%08X", bcast.id, bcast.mask);
    LOG_INF("CAN Initialized (29-bit extended)");
}

static void can_decode(const struct can_frame *f, can_packet_t *pkt)
{
    uint32_t id   = f->id;
    pkt->priority  = (id >> 26) & 0x07;
    pkt->src       = (id >> 14) & 0xFF;
    pkt->dst       = (id >>  6) & 0xFF;
    pkt->msg_class =  id        & 0x3F;
    pkt->dlc       = f->dlc;
    memcpy(pkt->data, f->data, f->dlc);
}

static void can_dispatch(const can_packet_t *pkt)
{
    switch (pkt->msg_class) {
        case CLS_HEARTBEAT:  handle_heartbeat(pkt);    break;
        case CLS_COMMAND:    handle_command(pkt);      break;
        case CLS_CMD_RESP:   handle_cmd_response(pkt); break;
        case CLS_TELEMETRY:  handle_telemetry(pkt);    break;
        case CLS_HEALTH:     handle_health(pkt);       break;
        default:
            LOG_WRN("Unhandled class: %d", pkt->msg_class);
            break;
    }
}

static int8_t q4_to_int8_c(int16_t t_q4)
{
    int32_t temp_c = (t_q4 + 8) / 16; /* rounded integer degC */
    if (temp_c > 127) {
        temp_c = 127;
    } else if (temp_c < -127) {
        temp_c = -127;
    }
    return (int8_t)temp_c;
}

static void send_cdh_temp_telemetry(void)
{
    cdh_temp_snapshot_t snap = {0};

    k_mutex_lock(&cdh_temp_lock, K_FOREVER);
    snap = cdh_temp_latest;
    k_mutex_unlock(&cdh_temp_lock);

    if (!snap.valid) {
        return;
    }

    struct can_frame f = {0};
    f.id = CAN_ID_FULL(PRIO_LOW, NODE_ID, CAN_BROADCAST, CLS_TELEMETRY);
    f.flags = CAN_FRAME_IDE;
    can_fill_payload(&f, NODE_ID, OP_CDH_TEMP_TELEM,
                     (uint8_t)snap.temp_c[0], (uint8_t)snap.temp_c[1],
                     (uint8_t)snap.temp_c[2], (uint8_t)snap.temp_c[3],
                     (uint8_t)snap.temp_c[4], (uint8_t)snap.temp_c[5]);
    can_send(can_dev, &f, K_NO_WAIT, NULL, NULL);
}

/* ===================================================== */
/* ================= MESSAGE HANDLERS =================== */
/* ===================================================== */

static void handle_cmd_response(const can_packet_t *pkt)
{
    LOG_INF("CmdResp from node 0x%x", pkt->src);
}

static void handle_telemetry(const can_packet_t *pkt)
{
    LOG_INF("Telemetry from node 0x%x", pkt->src);
}

static void handle_health(const can_packet_t *pkt)
{
    LOG_INF("Health from node 0x%x", pkt->src);
}

static void handle_command(const can_packet_t *pkt)
{
    uint8_t opcode = pkt->data[1];
    uint8_t val    = pkt->data[2];

    switch (opcode) {
        case OP_SET_MODE:
            current_mode = val;
            break;

        case OP_REBOOT:
            /* NVIC_SystemReset(); — enable after watchdog sequencing confirmed */
            break;

        case OP_SET_LED:
            LOG_INF("LED command: led2 -> %d", val);
            gpio_pin_set_dt(&led2, val);
            break;

        default:
            LOG_WRN("Unknown opcode: %d", opcode);
            break;
    }
}

static void handle_heartbeat(const can_packet_t *pkt)
{
    node_status_t *node = get_node_status(pkt->src);

    if (node == NULL) {
        LOG_WRN("Heartbeat from unknown node: 0x%02X", pkt->src);
        return;
    }

    node->alive        = true;
    node->last_seen_ms = k_uptime_get();

    LOG_INF("Heartbeat from 0x%02X - alive", pkt->src);
}

/*
 * check_node_timeouts() — Warn about nodes that have gone silent.
 *
 * NOTE: SOLAR entry uses SOLAR_ID (not STAR_ID — this fixes the bug
 * from the original code).
 */
static void check_node_timeouts(void)
{
    int64_t now = k_uptime_get();

    struct {
        uint8_t        id;
        const char    *name;
        node_status_t *status;
    } nodes[] = {
        { EPS_ID,   "EPS",   &node_alive.eps   },
        { COMMS_ID, "COMMS", &node_alive.comms },
        { ADCS_ID,  "ADCS",  &node_alive.adcs  },
        { MOTOR_ID, "MOTOR", &node_alive.motor },
        { GNSS_ID,  "GNSS",  &node_alive.gnss  },
        { STAR_ID,  "STAR",  &node_alive.star  },
        { SOLAR_ID, "SOLAR", &node_alive.solar },
    };

    for (int i = 0; i < ARRAY_SIZE(nodes); i++) {
        node_status_t *n = nodes[i].status;

        if (!n->alive) {
            continue;
        }

        if ((now - n->last_seen_ms) > HEARTBEAT_TIMEOUT_MS) {
            LOG_WRN("Node %s (0x%02X) timed out!", nodes[i].name, nodes[i].id);
            n->alive = false;
        }
    }
}

/* ===================================================== */
/* ================= SETUP MODE ========================= */
/* ===================================================== */

static void setup_mode_init(void)
{
    LOG_INF("Entering SETUP MODE");

    uint32_t uid[3];
    read_uid(uid);
    printk("UID: %08X-%08X-%08X\n", uid[0], uid[1], uid[2]);

    gpio_pin_configure(gpioa, PIN_ROLE, GPIO_INPUT);
    int role_pin = gpio_pin_get(gpioa, PIN_ROLE);
    printk("PA6 Role Pin: %d\n", role_pin);

    bool uid_is_mcu1 = (uid[0] == UID1_WORD0 &&
                        uid[1] == UID1_WORD1 &&
                        uid[2] == UID1_WORD2);

    bool uid_is_mcu2 = (uid[0] == UID2_WORD0 &&
                        uid[1] == UID2_WORD1 &&
                        uid[2] == UID2_WORD2);

    bool pin_is_mcu1 = (role_pin == 0);
    bool pin_is_mcu2 = (role_pin == 1);

    if ((uid_is_mcu1 && pin_is_mcu1) ||
        (uid_is_mcu2 && pin_is_mcu2)) {
        LOG_INF("MCU Identity Verified");
    } else {
        LOG_ERR("UID and PA6 MISMATCH — trusting PA6 hardware pin.");
    }

    tcan3403_wakeup();
    can_setup();

    LOG_INF("Setup complete — waiting 2 s for bus stabilisation");
    k_sleep(K_MSEC(2000));

    current_mode = MODE_STANDARD;
}

/* ===================================================== */
/* ================= THREADS ============================ */
/* ===================================================== */

void can_rx_thread(void *a, void *b, void *c)
{
    LOG_INF("can_rx_thread started");
    struct can_frame rx;

    while (1) {
        if (current_mode == MODE_STANDARD ||
            current_mode == MODE_MISSION)
        {
            if (k_msgq_get(&rxq, &rx, K_FOREVER) == 0) {
                LOG_INF("RX: id=0x%08X dlc=%d d0=0x%02X d1=0x%02X",
                        rx.id, rx.dlc, rx.data[0], rx.data[1]);

                if (k_msgq_put(&can_proc_q, &rx, K_NO_WAIT) != 0) {
                    LOG_WRN("CAN proc queue full — frame dropped");
                }
            }
        } else {
            k_sleep(K_MSEC(200));
        }
    }
}

void can_process_thread(void *a, void *b, void *c)
{
    LOG_INF("can_process_thread started");
    struct can_frame frame;
    can_packet_t pkt;

    while (1) {
        if (k_msgq_get(&can_proc_q, &frame, K_FOREVER) == 0) {
            led_can_activity();
            can_decode(&frame, &pkt);

            if (pkt.dst != NODE_ID && pkt.dst != CAN_BROADCAST) {
                continue;
            }

            can_dispatch(&pkt);
        }
    }
}

void scheduler_thread(void *a, void *b, void *c)
{
    LOG_INF("scheduler_thread started");
    int64_t last_hb = 0;

    while (1) {
        if (current_mode == MODE_STANDARD ||
            current_mode == MODE_MISSION)
        {
            int64_t now = k_uptime_get();

            if (now - last_hb >= 1000) {
                last_hb = now;
                send_simple(CAN_BROADCAST, CLS_HEARTBEAT, OP_HEARTBEAT, 0);
            }
        }

        k_sleep(K_MSEC(50));
    }
}

void soh_thread(void *a, void *b, void *c)
{
    LOG_INF("soh_thread started");

    while (1) {
        if (current_mode == MODE_STANDARD ||
            current_mode == MODE_MISSION)
        {
            struct temp_telemetry telem;
            temp_telemetry_read_all(i2c_bus, &telem);
            temp_telemetry_print(&telem);

            cdh_temp_snapshot_t snap = {.valid = true};
            for (int i = 0; i < NUM_TEMP_SENSORS; i++) {
                if (telem.s[i].status == 0) {
                    snap.temp_c[i] = q4_to_int8_c(telem.s[i].temp_q4);
                } else {
                    snap.temp_c[i] = INT8_MIN; /* sensor error sentinel */
                }
            }

            k_mutex_lock(&cdh_temp_lock, K_FOREVER);
            cdh_temp_latest = snap;
            k_mutex_unlock(&cdh_temp_lock);

            check_node_timeouts();
        }

        k_sleep(K_MSEC(500));
    }
}

void watchdog_thread(void *a, void *b, void *c)
{
    LOG_INF("watchdog_thread started");

    while (1) {
        /* TODO: Replace with correct kick sequence for your watchdog IC */
        /* gpio_pin_toggle(gpioa, WATCHDOG_PIN); */

        LOG_DBG("watchdog kick");

        k_sleep(K_MSEC(WATCHDOG_KICK_MS));
    }
}

void gnss_thread(void *a, void *b, void *c)
{
    LOG_INF("gnss_thread started");

    while (1) {
        if (current_mode == MODE_STANDARD ||
            current_mode == MODE_MISSION)
        {
            /* TODO: Send paramget request to GNSS node over CAN */
            LOG_INF("GNSS poll - placeholder");
        }

        k_sleep(K_MSEC(GNSS_POLL_MS));
    }
}

void telemetry_thread(void *a, void *b, void *c)
{
    LOG_INF("telemetry_thread started");

    while (1) {
        if (current_mode == MODE_STANDARD ||
            current_mode == MODE_MISSION)
        {
            send_cdh_temp_telemetry();
        }

        k_sleep(K_MSEC(TELEMETRY_CHECK_MS));
    }
}

/* ===================================================== */
/* ================= MAIN =============================== */
/* ===================================================== */

int main(void)
{
    LOG_INF("UT-CORE CDH Booting...");

    leds_init();

    k_thread_create(&watchdog_thread_data, watchdog_stack, STACK_SIZE,
                    watchdog_thread, NULL, NULL, NULL,
                    PRIO_WATCHDOG, 0, K_NO_WAIT);

    k_thread_create(&can_thread_data, can_stack, STACK_SIZE,
                    can_rx_thread, NULL, NULL, NULL,
                    PRIO_CAN_RX, 0, K_NO_WAIT);

    k_thread_create(&can_proc_thread_data, can_proc_stack, STACK_SIZE,
                    can_process_thread, NULL, NULL, NULL,
                    PRIO_CAN_PROC, 0, K_NO_WAIT);

    k_thread_create(&sched_thread_data, sched_stack, STACK_SIZE,
                    scheduler_thread, NULL, NULL, NULL,
                    PRIO_SCHED, 0, K_NO_WAIT);

    k_thread_create(&gnss_thread_data, gnss_stack, STACK_SIZE,
                    gnss_thread, NULL, NULL, NULL,
                    PRIO_GNSS, 0, K_NO_WAIT);

    k_thread_create(&soh_thread_data, soh_stack, STACK_SIZE,
                    soh_thread, NULL, NULL, NULL,
                    PRIO_SOH, 0, K_NO_WAIT);

    k_thread_create(&telemetry_thread_data, telemetry_stack, STACK_SIZE,
                    telemetry_thread, NULL, NULL, NULL,
                    PRIO_TELEMETRY, 0, K_NO_WAIT);

    setup_mode_init();

    while (1) {
        k_sleep(K_FOREVER);
    }
}
```

## src/main.cpp
```c
// main.cpp — CDH "logical flow" app skeleton (Zephyr + C++)
// NOTE: This is intentionally hardware-stubbed. Replace hw_*() with real drivers.

extern "C" {
#include <zephyr/kernel.h>
#include <zephyr/sys/printk.h>
#include <zephyr/sys/util.h>
#include <string.h>
}

#include <cstdint>
#include <array>

/* =========================
 *  CAN envelope definitions
 * ========================= */
struct CanHeader {
  uint8_t prio;     // 3 bits
  uint8_t class_id; // 5 bits
  uint8_t src;      // 6 bits
  uint8_t dst;      // 6 bits
  uint16_t inst;    // 9 bits
};

struct CanMsg {
  CanHeader h{};
  uint8_t dlc{0};
  std::array<uint8_t, 8> data{};
};

static constexpr uint8_t CDH_NODE_ID = 0x01;
static constexpr uint8_t BROADCAST  = 0x00;

/* Message classes (per doc) */
enum : uint8_t {
  CLASS_HEARTBEAT = 0,
  CLASS_TIMESYNC  = 1,
  CLASS_COMMAND   = 2,
  CLASS_CMDRESP   = 3,
  CLASS_TELEM     = 4,
  CLASS_EVENT     = 5,
  CLASS_PARAMGET  = 6,
  CLASS_PARAMSET  = 7,
  CLASS_PARAMRESP = 8,
  CLASS_FILE      = 9,
  CLASS_BOOT      = 10,
  CLASS_HEALTH    = 11,
};

static inline CanHeader decode_id(uint32_t id29) {
  // id29 bits: [P:3][CLASS:5][SRC:6][DST:6][INST:9] = 29 bits total
  CanHeader h{};
  h.prio     = (id29 >> 26) & 0x7;
  h.class_id = (id29 >> 21) & 0x1F;
  h.src      = (id29 >> 15) & 0x3F;
  h.dst      = (id29 >> 9)  & 0x3F;
  h.inst     = (id29 >> 0)  & 0x1FF;
  return h;
}

static inline uint32_t encode_id(const CanHeader& h) {
  return ((uint32_t(h.prio & 0x7)     << 26) |
          (uint32_t(h.class_id & 0x1F) << 21) |
          (uint32_t(h.src & 0x3F)      << 15) |
          (uint32_t(h.dst & 0x3F)      << 9)  |
          (uint32_t(h.inst & 0x1FF)    << 0));
}

/* =========================
 *  Hardware stubs (replace)
 * ========================= */
static bool hw_can_read_raw(uint32_t& out_id29, uint8_t& out_dlc, uint8_t out_data[8]) {
  // TODO: replace with zephyr CAN driver receive; block or poll depending on your API choice.
  // Return true if a frame was read.
  (void)out_id29; (void)out_dlc; (void)out_data;
  k_sleep(K_MSEC(10));
  return false;
}

static void hw_can_send(const CanMsg& m) {
  // TODO: replace with zephyr CAN send
  (void)m;
}

static void hw_watchdog_kick() {
  // TODO: replace with zephyr watchdog driver kick
}

static uint32_t hw_uptime_ms() {
  return (uint32_t)k_uptime_get_32();
}

/* =========================
 *  System state / mode mgmt
 * ========================= */
enum class Mode : uint8_t { BOOT=0, SAFE=1, STANDBY=2, OP=3, FAULT=4, SHUTDOWN=5 };

struct SystemState {
  Mode mode{Mode::BOOT};
  uint32_t boot_ms{0};
  uint32_t hb_seq{0};
  uint32_t last_timesync_ms{0};

  // “health-ish” placeholders
  int16_t board_temp_c_x100{2500}; // 25.00C
  bool eps_alive{false};
  bool comms_alive{false};
  bool adcs_alive{false};
};

static SystemState g_state;

/* =========================
 *  Queues between services
 * ========================= */
K_MSGQ_DEFINE(can_rx_q, sizeof(CanMsg), 64, 4);

enum class LogType : uint8_t { TELEM, EVENT, ERROR };

struct LogItem {
  LogType type{};
  uint32_t t_ms{};
  uint16_t code{};
  std::array<uint8_t, 16> payload{}; // keep small for now
};

K_MSGQ_DEFINE(log_q, sizeof(LogItem), 128, 4);

/* =========================
 *  Command IDs (INST values)
 *  (examples from doc)
 * ========================= */
enum : uint16_t {
  CMD_PING          = 0,
  CMD_SET_MODE      = 1,
  CMD_GET_STATUS    = 2,
  CMD_REBOOT        = 3,
  // add the rest
};

/* =========================
 *  Helpers: responding
 * ========================= */
static void send_cmd_resp(uint8_t dst, uint16_t cmd_inst, int8_t status, uint8_t seq, const uint8_t* data=nullptr, uint8_t len=0) {
  CanMsg m{};
  m.h.prio     = 2;
  m.h.class_id = CLASS_CMDRESP;
  m.h.src      = CDH_NODE_ID;
  m.h.dst      = dst;
  m.h.inst     = cmd_inst;
  m.dlc        = MIN<uint8_t>(8, (uint8_t)(2 + len));
  m.data[0]    = (uint8_t)status;
  m.data[1]    = seq;
  for (uint8_t i = 0; i < len && (2+i) < 8; i++) m.data[2+i] = data[i];
  hw_can_send(m);
}

static void log_event(uint16_t code) {
  LogItem it{};
  it.type = LogType::EVENT;
  it.t_ms = hw_uptime_ms();
  it.code = code;
  (void)k_msgq_put(&log_q, &it, K_NO_WAIT);
}

/* =========================
 *  Mode manager logic
 * ========================= */
static void request_mode(Mode m) {
  if (g_state.mode == m) return;

  // Example policy: if going to OP, require EPS + COMMS alive; else bounce to SAFE.
  if (m == Mode::OP && !(g_state.eps_alive && g_state.comms_alive)) {
    g_state.mode = Mode::SAFE;
    log_event(/*ModeChange*/ 0x0001);
    return;
  }

  g_state.mode = m;
  log_event(/*ModeChange*/ 0x0001);

  // TODO: tell EPS to power stuff based on mode (stubbed)
  // ex: eps_set_rail("ADCS", m==Mode::OP);
}

/* =========================
 *  Param service (skeleton)
 * ========================= */
static void handle_param_get(const CanMsg& msg) {
  // msg.h.inst could be parameter key. Respond with ParamResp.
  // You might keep a small parameter store in FRAM later.
  CanMsg resp{};
  resp.h.prio     = 2;
  resp.h.class_id = CLASS_PARAMRESP;
  resp.h.src      = CDH_NODE_ID;
  resp.h.dst      = msg.h.src;
  resp.h.inst     = msg.h.inst;
  resp.dlc        = 2;
  resp.data[0]    = 0;     // status=OK
  resp.data[1]    = 0;     // seq placeholder
  hw_can_send(resp);
}

static void handle_param_set(const CanMsg& msg) {
  // Validate + apply; ack with ParamResp.
  (void)msg;
}

/* =========================
 *  File service (skeleton)
 * ========================= */
static void handle_file_msg(const CanMsg& msg) {
  // Implement FILE_BEGIN / FILE_CHUNK / FILE_ACK / FILE_END later.
  (void)msg;
}

/* =========================
 *  Command handlers
 * ========================= */
using CmdHandler = void(*)(const CanMsg&);

static void cmd_ping(const CanMsg& msg) {
  // respond success
  send_cmd_resp(msg.h.src, msg.h.inst, /*status*/0, /*seq*/msg.data[0]);
}

static void cmd_set_mode(const CanMsg& msg) {
  // Example: data[1] = desired mode enum
  uint8_t seq = msg.data[0];
  Mode desired = (Mode)msg.data[1];

  request_mode(desired);
  send_cmd_resp(msg.h.src, msg.h.inst, 0, seq);
}

static void cmd_get_status(const CanMsg& msg) {
  uint8_t seq = msg.data[0];
  uint8_t out[6]{};
  out[0] = (uint8_t)g_state.mode;
  uint32_t up = hw_uptime_ms();
  memcpy(&out[1], &up, 4);
  out[5] = (uint8_t)g_state.hb_seq;
  send_cmd_resp(msg.h.src, msg.h.inst, 0, seq, out, sizeof(out));
}

static void cmd_reboot(const CanMsg& msg) {
  uint8_t seq = msg.data[0];
  send_cmd_resp(msg.h.src, msg.h.inst, 0, seq);
  // TODO: trigger system reboot (sys_reboot) later
}

/* simple handler table */
static CmdHandler g_cmd_table[32] = {
  /*0*/ cmd_ping,
  /*1*/ cmd_set_mode,
  /*2*/ cmd_get_status,
  /*3*/ cmd_reboot,
  // rest null
};

/* =========================
 *  Router
 * ========================= */
static bool is_for_us(const CanMsg& msg) {
  return (msg.h.dst == CDH_NODE_ID) || (msg.h.dst == BROADCAST);
}

static void dispatch(const CanMsg& msg) {
  if (!is_for_us(msg)) return;

  switch (msg.h.class_id) {
    case CLASS_COMMAND: {
      uint16_t cmd_id = msg.h.inst;
      if (cmd_id < ARRAY_SIZE(g_cmd_table) && g_cmd_table[cmd_id]) {
        g_cmd_table[cmd_id](msg);
      } else {
        // unknown command -> respond error if addressed to us
        if (msg.h.dst == CDH_NODE_ID) {
          send_cmd_resp(msg.h.src, msg.h.inst, /*status*/-1, /*seq*/msg.data[0]);
        }
      }
    } break;

    case CLASS_PARAMGET:  handle_param_get(msg); break;
    case CLASS_PARAMSET:  handle_param_set(msg); break;
    case CLASS_FILE:      handle_file_msg(msg);  break;

    case CLASS_HEARTBEAT:
      // update liveness map based on msg.h.src, msg.data fields, etc.
      // g_state.eps_alive = ...
      break;

    case CLASS_TIMESYNC:
      // if CDH is master you might ignore; if not, update time base
      g_state.last_timesync_ms = hw_uptime_ms();
      break;

    default:
      break;
  }
}

/* =========================
 *  Threads
 * ========================= */
static void can_rx_thread(void*, void*, void*) {
  uint32_t id29{};
  uint8_t dlc{};
  uint8_t data[8]{};

  while (true) {
    if (!hw_can_read_raw(id29, dlc, data)) {
      continue;
    }

    CanMsg m{};
    m.h   = decode_id(id29);
    m.dlc = dlc;
    for (uint8_t i = 0; i < 8; i++) m.data[i] = data[i];

    // Drop if queue full (or block if you prefer K_FOREVER)
    (void)k_msgq_put(&can_rx_q, &m, K_NO_WAIT);
  }
}

static void router_thread(void*, void*, void*) {
  CanMsg m{};
  while (true) {
    k_msgq_get(&can_rx_q, &m, K_FOREVER);
    dispatch(m);
  }
}

static void storage_thread(void*, void*, void*) {
  LogItem it{};
  while (true) {
    k_msgq_get(&log_q, &it, K_FOREVER);
    // TODO: write to eMMC / filesystem later
    // For now, just print
    printk("[LOG] t=%u type=%u code=0x%04x\n", it.t_ms, (uint8_t)it.type, it.code);
  }
}

/* =========================
 *  Periodic work items
 * ========================= */
static k_work_delayable hb_work;
static k_work_delayable timesync_work;
static k_work_delayable wdog_work;
static k_work_delayable telem_work;

static void hb_work_fn(k_work*) {
  CanMsg hb{};
  hb.h.prio     = 2;
  hb.h.class_id = CLASS_HEARTBEAT;
  hb.h.src      = CDH_NODE_ID;
  hb.h.dst      = BROADCAST;
  hb.h.inst     = 0;

  // Example heartbeat payload (map to doc):
  // state, version_major, version_minor, uptime_s (2 bytes), seq
  hb.dlc = 8;
  hb.data[0] = (uint8_t)g_state.mode;
  hb.data[1] = 1; // ver major
  hb.data[2] = 0; // ver minor
  uint32_t up_s = hw_uptime_ms() / 1000U;
  memcpy(&hb.data[3], &up_s, 4);
  hb.data[7] = (uint8_t)(g_state.hb_seq++);

  hw_can_send(hb);

  // reschedule
  k_work_schedule(&hb_work, K_MSEC(500));
}

static void timesync_work_fn(k_work*) {
  // If CDH is the time master: broadcast unix time (or mission time)
  // Here: just broadcast uptime_ms as placeholder.
  CanMsg ts{};
  ts.h.prio     = 0;
  ts.h.class_id = CLASS_TIMESYNC;
  ts.h.src      = CDH_NODE_ID;
  ts.h.dst      = BROADCAST;
  ts.h.inst     = 0;

  ts.dlc = 8;
  uint32_t t = hw_uptime_ms();
  memcpy(&ts.data[0], &t, 4);
  memset(&ts.data[4], 0, 4);
  hw_can_send(ts);

  k_work_schedule(&timesync_work, K_SECONDS(1));
}

static void wdog_work_fn(k_work*) {
  hw_watchdog_kick();
  k_work_schedule(&wdog_work, K_MSEC(250)); // tune to your watchdog window
}

static void telem_work_fn(k_work*) {
  // Push a log item (later: also send CAN telemetry packets)
  LogItem it{};
  it.type = LogType::TELEM;
  it.t_ms = hw_uptime_ms();
  it.code = 0x1000; // CDH_SYS placeholder
  (void)k_msgq_put(&log_q, &it, K_NO_WAIT);

  k_work_schedule(&telem_work, K_MSEC(1000));
}

/* =========================
 *  Thread definitions
 * ========================= */
K_THREAD_STACK_DEFINE(can_rx_stack, 2048);
K_THREAD_STACK_DEFINE(router_stack, 2048);
K_THREAD_STACK_DEFINE(storage_stack, 2048);

static k_thread can_rx_t;
static k_thread router_t;
static k_thread storage_t;

int main() {
  g_state.boot_ms = hw_uptime_ms();
  printk("CDH app start\n");

  // Init delayed work
  k_work_init_delayable(&hb_work, hb_work_fn);
  k_work_init_delayable(&timesync_work, timesync_work_fn);
  k_work_init_delayable(&wdog_work, wdog_work_fn);
  k_work_init_delayable(&telem_work, telem_work_fn);

  // Start threads
  k_thread_create(&can_rx_t, can_rx_stack, K_THREAD_STACK_SIZEOF(can_rx_stack),
                  can_rx_thread, nullptr, nullptr, nullptr,
                  /*prio*/ 1, 0, K_NO_WAIT);

  k_thread_create(&router_t, router_stack, K_THREAD_STACK_SIZEOF(router_stack),
                  router_thread, nullptr, nullptr, nullptr,
                  /*prio*/ 2, 0, K_NO_WAIT);

  k_thread_create(&storage_t, storage_stack, K_THREAD_STACK_SIZEOF(storage_stack),
                  storage_thread, nullptr, nullptr, nullptr,
                  /*prio*/ 5, 0, K_NO_WAIT);

  // Kick off periodic jobs
  k_work_schedule(&hb_work, K_MSEC(200));
  k_work_schedule(&timesync_work, K_SECONDS(1));
  k_work_schedule(&wdog_work, K_MSEC(250));
  k_work_schedule(&telem_work, K_MSEC(1000));

  // Mode enters SAFE after boot unless we decide otherwise
  request_mode(Mode::SAFE);

  // Main thread can sleep forever; system lives in threads/work items
  k_sleep(K_FOREVER);
  return 0;
}
```

## src/board_config.h
```c
#pragma once

/*
 * UT-CORE CDH — Board Configuration
 *
 * Hardware-specific definitions for the CDH flight computer.
 * MCU: STM32U5, RTOS: Zephyr, CAN transceiver: TCAN3403.
 *
 * Keeps the main application code free of raw pin numbers, UID
 * constants, and devicetree boilerplate.
 */

#include <zephyr/device.h>
#include <zephyr/drivers/gpio.h>
#include <zephyr/drivers/can.h>
#include <zephyr/drivers/i2c.h>

/* ================= Node Identity ================= */

#define NODE_ID     0x01      /* This board's CAN node address (== CDH_ID) */
#define DST_ME      NODE_ID
#define PRIO_LOW    3         /* Default CAN priority for outbound frames  */

/* ================= Devicetree Nodes ================= */

#define CAN_NODE     DT_NODELABEL(fdcan1)
#define I2C_BUS_NODE DT_NODELABEL(i2c1)
#define GPIOA_NODE   DT_NODELABEL(gpioa)
#define LED0_NODE    DT_ALIAS(led0)
#define LED1_NODE    DT_ALIAS(led1)
#define LED2_NODE    DT_ALIAS(led2)

/* ================= GPIO Pin Assignments ================= */

#define PIN_SILENT   9        /* TCAN3403 silent-mode control (active high) */
#define PIN_SHDN     10       /* TCAN3403 shutdown control (active high)    */
#define PIN_ROLE     6        /* MCU role strap — 0 = MCU1, 1 = MCU2       */
#define WATCHDOG_PIN 2        /* Hardware watchdog kick pin (PA2)           */

/* ================= STM32U5 96-bit Factory UIDs ================= */
/*
 * Used at boot to cross-check hardware identity against the role strap pin.
 * Read from UID_BASE in flash info area.
 */

#define UID1_WORD0 0x00340016
#define UID1_WORD1 0x41425007
#define UID1_WORD2 0x20363651

#define UID2_WORD0 0x0012001B
#define UID2_WORD1 0x41425007
#define UID2_WORD2 0x20363651

/* ================= Thread Configuration ================= */
/*
 * Priority 0 is reserved for the watchdog — it must always be able to kick
 * the hardware timer regardless of what any other thread is doing.
 */

#define PRIO_WATCHDOG   0     /* Highest — hardware watchdog kick           */
#define PRIO_CAN_RX     1     /* Drain hardware FIFO immediately            */
#define PRIO_CAN_PROC   2     /* Decode & dispatch frames from SW queue     */
#define PRIO_SCHED      3     /* Heartbeat + mission scheduling             */
#define PRIO_GNSS       4     /* Request & store GNSS position data         */
#define PRIO_SOH        5     /* Read temps & check node timeouts           */
#define PRIO_TELEMETRY  6     /* Lowest — assemble & downlink telemetry     */

#define STACK_SIZE 1024

/* ================= Timing Constants ================= */

#define HEARTBEAT_TIMEOUT_MS  5000  /* Node declared dead after this silence */
#define WATCHDOG_KICK_MS      15    /* Must be < half HW watchdog timeout    */
#define GNSS_POLL_MS          5000  /* How often to request a GNSS fix       */
#define TELEMETRY_CHECK_MS    1000  /* Downlink window / SOH check cadence   */

/* ================= CAN Processing Queue ================= */

#define CAN_PROC_Q_LEN 32    /* SW queue depth between RX and process threads */
```
