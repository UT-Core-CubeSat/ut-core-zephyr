## CMakeLists.txt
```
cmake_minimum_required(VERSION 3.20.0)
find_package(Zephyr REQUIRED HINTS $ENV{ZEPHYR_BASE})
project(cdh)


# C / C++ sources
target_sources(app PRIVATE
src/can_bus.c
src/soh.c
src/internal_sensors.c
src/ground_cmds.c
src/app_main.cpp
)


target_include_directories(app PRIVATE ${CMAKE_CURRENT_SOURCE_DIR}/include)
```

## prj.conf
```kconfig
# ===== Console & logging =====
CONFIG_LOG=y
CONFIG_LOG_MODE_DEFERRED=y
CONFIG_STDOUT_CONSOLE=y
CONFIG_UART_CONSOLE=y


# ===== Core kernel & power =====
CONFIG_TICKLESS_KERNEL=y
CONFIG_PM=y
CONFIG_PM_DEVICE=y
CONFIG_PM_DEVICE_RUNTIME=y


# ===== Drivers =====
CONFIG_GPIO=y
CONFIG_CAN=y
CONFIG_CAN_DEFAULT_BITRATE=500000
CONFIG_SENSOR=y # for internal sensors later
CONFIG_WATCHDOG=y # plan to feed IWDG


# ===== C++ =====
CONFIG_CPP=y
CONFIG_NEWLIB_LIBC=y
CONFIG_GLIBCXX_LIBCPP=y
# Keep these off unless needed:
# CONFIG_CPP_EXCEPTIONS=y
# CONFIG_RTTI=y


# ===== Settings / NVS (store IDs/config) =====
CONFIG_SETTINGS=y
CONFIG_SETTINGS_NVS=y
CONFIG_FLASH=y
CONFIG_NVS=y
```

## boards/nucleo_u5a5zj_q.overlay
```dts
/ { chosen { zephyr,canbus = &fdcan1; }; };
&fdcan1 { status = "okay"; };
```

## include/cdh_can_proto.h
```c
#pragma once
#include <stdint.h>
#include <zephyr/drivers/can.h>
#ifdef __cplusplus
extern "C" {
    #endif


    /* 11-bit ID layout: prio[10:8] | dst[7:4] | cls[3:0] */
    #define CAN_PRIO(p) (((p) & 0x7) << 8)
    #define CAN_DST(d) (((d) & 0xF) << 4)
    #define CAN_CLS(c) ((c) & 0xF)
    #define CAN_ID(prio, dst, cls) (CAN_PRIO(prio) | CAN_DST(dst) | CAN_CLS(cls))


    #define CAN_DST_MASK 0x0F0
    #define CAN_BROADCAST 0xF


    /* classes */
    enum can_cls {
        CLS_CORE = 0x0,
        CLS_TLM = 0x1,
        CLS_CMD = 0x2,
        CLS_SOH = 0x3,
    };


    /* opcodes in payload[1] */
    enum can_op {
        OP_PING = 0x01,
        OP_PONG = 0x02,
        OP_BUTTON = 0x10,
        OP_SET_LED = 0x20,
        OP_SOH_FRAME = 0x30,
        OP_GROUND_CMD= 0x40,
    };


    struct can_payload {
        uint8_t src; /* payload[0] */
        uint8_t op; /* payload[1] */
        uint8_t p2, p3, p4, p5, p6, p7;
    };


    static inline void can_fill_payload(struct can_frame *f,
    uint8_t src, uint8_t op,
    uint8_t p2,uint8_t p3,uint8_t p4,
    uint8_t p5,uint8_t p6,uint8_t p7)
    {
    f->dlc = 8; f->flags = 0;
    f->data[0]=src; f->data[1]=op; f->data[2]=p2; f->data[3]=p3;
    f->data[4]=p4; f->data[5]=p5; f->data[6]=p6; f->data[7]=p7;
    }


    #ifdef __cplusplus
}
#endif
```

## include/cdh_events.h
```c
#pragma once
#include <stdint.h>
#ifdef __cplusplus
extern "C" {
    #endif


    typedef enum {
        EV_CAN_RX = 1,
        EV_GROUND_CMD,
        EV_SOH_TICK,
        EV_SCHED_TICK,
        EV_MODE_TICK,
        EV_WATCHDOG_TICK,
    } cdh_event_type_t;


    struct cdh_event {
        cdh_event_type_t type;
        uint32_t arg0;
        uint32_t arg1;
    };


    #ifdef __cplusplus
}
#endif
```

## include/cdh_modes.h
```c
#pragma once
#ifdef __cplusplus
extern "C" {
    #endif


    enum cdh_mode {
        CDH_MODE_STANDBY = 0,
        CDH_MODE_LOW_POWER,
        CDH_MODE_SLEEP,
        CDH_MODE_DEEP_SLEEP,
        CDH_MODE_OPERATIONAL
    };


    #ifdef __cplusplus
}
#endif
```

## src/can_bus.c
```c
#include <zephyr/kernel.h>
#include <zephyr/device.h>
#include <zephyr/drivers/can.h>
#include <zephyr/logging/log.h>
#include "can_bus.h"


LOG_MODULE_REGISTER(can_bus, LOG_LEVEL_INF);


CAN_MSGQ_DEFINE(cdh_can_rxq, 16);


int can_bus_init(const struct device **out_dev) {
    const struct device *can_dev = DEVICE_DT_GET(DT_CHOSEN(zephyr_canbus));
    if (!device_is_ready(can_dev)) return -ENODEV;


    (void)can_stop(can_dev);
    (void)can_set_mode(can_dev, CAN_MODE_NORMAL); /* CDH is active node */
    if (can_start(can_dev)) return -EIO;


    /* Receive frames addressed to CDH and broadcasts */
    struct can_filter to_me = { .id = CAN_DST(CDH_NODE_ID), .mask = CAN_DST_MASK, .flags = 0 };
    struct can_filter bcast = { .id = CAN_DST(CAN_BROADCAST), .mask = CAN_DST_MASK, .flags = 0 };
    can_add_rx_filter_msgq(can_dev, &cdh_can_rxq, &to_me);
    can_add_rx_filter_msgq(can_dev, &cdh_can_rxq, &bcast);


    if (out_dev) *out_dev = can_dev;
    return 0;
}


int can_bus_send_u8(const struct device *dev, uint16_t id, uint8_t src, uint8_t op, uint8_t a,uint8_t b,uint8_t c,uint8_t d,uint8_t e,uint8_t f) {
    struct can_frame f = { .id = id };
    can_fill_payload(&f, src, op, a,b,c,d,e,f);
    return can_send(dev, &f, K_MSEC(200), NULL, NULL);
}


int can_bus_try_get(struct can_frame *out) {
    if (!out) return -EINVAL;
    return k_msgq_get(&cdh_can_rxq, out, K_NO_WAIT);
}
```

## src/can_bus.h
```c
#pragma once
#include <zephyr/drivers/can.h>
#include "cdh_can_proto.h"
#include "cdh_events.h"
#ifdef __cplusplus
extern "C" {
    #endif


    #define CDH_NODE_ID 0x1 /* logical CDH node id */


    int can_bus_init(const struct device **out_dev);
    int can_bus_send_u8(const struct device *dev, uint16_t id,
    uint8_t src, uint8_t op,
    uint8_t a,uint8_t b,uint8_t c,uint8_t d,uint8_t e,uint8_t f);


    /* Non-blocking get of an incoming frame; returns 0 if got one */
    int can_bus_try_get(struct can_frame *out);


    #ifdef __cplusplus
}
#endif
```

## src/ground_cmds.c
```c
#include <zephyr/logging/log.h>
#include "cdh_can_proto.h"
#include "ground_cmds.h"
LOG_MODULE_REGISTER(ground_cmds, LOG_LEVEL_INF);


int ground_cmd_handle(const struct can_frame *f) {
    if (!f) 
        return -1;

    const uint8_t op = f->data[1];
    
    switch (op) {
        case OP_GROUND_CMD:
        LOG_INF("Ground command: p2=%u p3=%u", f->data[2], f->data[3]);
        /* TODO: decode and trigger actions */
        return 0;
        default:
        return -2;
    }
}
```

## src/ground_cmds.h
```c
#pragma once
#include <stdint.h>
#include <zephyr/drivers/can.h>
#ifdef __cplusplus
extern "C" {
    #endif


    /* Decode a ground command in a CAN frame; return 0 if handled */
    int ground_cmd_handle(const struct can_frame *f);


    #ifdef __cplusplus
}
#endif
```

## src/internal_sensors.c
```c
#include "internal_sensors.h"
int internal_sensors_init(void) { 
    return 0;
}
int internal_sensors_read(struct internal_readings *out) {
    if (!out) return -1;
    /* TODO: hook to real ADC/sensor drivers */
    out->mcu_temp_c10 = 250; /* 25.0 C */
    out->vbus_mv = 5000; /* 5.0 V */
    return 0;
}
```

## src/internal_sensors.h
```c
#pragma once
#include <stdint.h>
#ifdef __cplusplus
extern "C" {
    #endif


    struct internal_readings {
        int16_t mcu_temp_c10; /* 10x degC */
        uint16_t vbus_mv;
    };


    int internal_sensors_init(void);
    int internal_sensors_read(struct internal_readings *out);


    #ifdef __cplusplus
}
#endif
```

## src/main_app.cpp
```c
#include <zephyr/kernel.h>

void periodic_soh() {
    int64_t now = k_uptime_get();

    if (now - last_soh_ < SOH_PERIOD_MS) 
        return;
    last_soh_ = now;


    internal_readings r{}; 
    (void)internal_sensors_read(&r);
    soh_packet p{}; 
    p.mcu_temp_c10 = r.mcu_temp_c10; 
    p.bus_v_mv     = r.vbus_mv; 
    p.mode         = (uint8_t)mode_;
    soh_update_comm_stats(&p, rx_count_, tx_count_);


    /* Transmit a compact SOH frame (example) to broadcast */
    can_bus_send_u8(can_, CAN_ID(2, CAN_BROADCAST, CLS_SOH),
    CDH_NODE_ID, OP_SOH_FRAME,
    (uint8_t)(p.bus_v_mv/20), /*coarse*/
    (uint8_t)(p.mcu_temp_c10/5),
    p.mode,
    (uint8_t)(p.rx_count & 0xFF), (uint8_t)(p.tx_count & 0xFF), 0);
}


/* === Link & experiment scheduling (stub hooks) === */
void periodic_schedule() {
    int64_t now = k_uptime_get();
    if (now - last_sched_ < SCHED_PERIOD_MS) return;
    last_sched_ = now;
    // TODO: compute next downlink/uplink window; compute next experiment pass time
}


/* === Mode management === */
void periodic_modes() {
    int64_t now = k_uptime_get();
    if (now - last_mode_ < MODE_PERIOD_MS) return;
    last_mode_ = now;


    /* Simple example: if bus voltage low, go low-power */
    // TODO: read real numbers; for now, keep OPERATIONAL
    mode_ = CDH_MODE_OPERATIONAL;
}


/* === Watchdog / health === */
void periodic_watchdog() {
    int64_t now = k_uptime_get();
    if (now - last_wd_ < WD_PERIOD_MS) return;
    last_wd_ = now;
    // TODO: feed hardware watchdog; monitor subsystem pings, mark faults
}


private:
const struct device *can_ = nullptr;
enum cdh_mode mode_ = CDH_MODE_STANDBY;
bool led_on_ = false;
uint16_t rx_count_ = 0; 
tx_count_ = 0; // hook into can callbacks to maintain
int64_t last_soh_{} , last_sched_{}, last_mode_{}, last_wd_{};
};


extern "C" int main(void) {
    CdhApp app;
    if (app.init() != 0) {
        LOG_ERR("CDH init failed");
        return 0;
    }
    LOG_INF("CDH app started");
    app.run();
    return 0;
}
```

## src/soh.c
```c
#include "soh.h"

void soh_init(void) {
    /* nothing to do yet */
}

void soh_update_from_internal_sensors(struct soh_packet *p) {
    (void)p; /* fill from internal_sensors later */
}

void soh_update_comm_stats(struct soh_packet *p, uint16_t rx, uint16_t tx) {
    if (!p) return;
    p->rx_count = rx;
    p->tx_count = tx;
}
```

## src/soh.h
```c
#pragma once
#include <stdint.h>
#ifdef __cplusplus
extern "C" {
    #endif


    struct soh_packet {
        /* add fields as needed */
        uint16_t bus_v_mv;
        int16_t mcu_temp_c10; /* 10x degC */
        uint16_t rx_count;
        uint16_t tx_count;
        uint8_t mode;
    };


    void soh_init(void);
    void soh_update_from_internal_sensors(struct soh_packet *p);
    void soh_update_comm_stats(struct soh_packet *p, uint16_t rx, uint16_t tx);


    #ifdef __cplusplus
}
#endif
```
