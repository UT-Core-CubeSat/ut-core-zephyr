## app/adcsComputeTest/airBearingDemo/orion/Kconfig
```kconfig
# Kconfig for Orion B16 GNSS module

config ORION_B16
	bool "Orion B16 GNSS Driver"
	default y
	depends on SERIAL && UART_INTERRUPT_DRIVEN
	help
	  Enable the Orion B16 (SkyTraq) GNSS driver.
	  Provides binary protocol parsing, command building,
	  and a high-level API for position/velocity/time data.

if ORION_B16

config ORION_B16_SIMULATOR
	bool "Orion B16 GNSS Simulator"
	default n
	help
	  Include the Orion B16 GNSS simulator module.
	  This simulates a GNSS receiver on a second UART,
	  useful for testing without hardware.

config ORION_B16_LOG_LEVEL
	int "Orion B16 log level"
	default 3
	range 0 4
	help
	  Log level for the Orion B16 driver modules.
	  0=OFF, 1=ERR, 2=WRN, 3=INF, 4=DBG

config ORION_B16_UPDATE_RATE
	int "Default position update rate (Hz)"
	default 1
	range 1 50
	help
	  Default position update rate in Hz.
	  Valid values: 1, 2, 4, 5, 8, 10, 20, 25, 40, 50.
	  Higher rates require higher baud rates.

config ORION_B16_BAUD_RATE
	int "UART baud rate"
	default 115200
	help
	  Baud rate for the UART connection to the Orion B16.
	  Common values: 9600, 38400, 57600, 115200, 230400.

config ORION_B16_UART_DEV_NAME
	string "UART device name"
	default "UART_1"
	help
	  Zephyr UART device name for the Orion B16 connection.
	  Must match your board's devicetree configuration.

endif # ORION_B16
```

## boards/arm/ut_core/ut_core_defconfig
```kconfig
CONFIG_GPIO=y

# No console yet
CONFIG_SERIAL=n
CONFIG_CONSOLE=n
CONFIG_UART_CONSOLE=n

CONFIG_ARM_MPU=y
CONFIG_HW_STACK_PROTECTION=y

# Keep clock control on (STM32 needs it)
CONFIG_CLOCK_CONTROL=y
CONFIG_CLOCK_CONTROL_STM32_CUBE=y

CONFIG_I2C=y
CONFIG_I2C_STM32=y

CONFIG_SPI=y
CONFIG_SPI_STM32=y

CONFIG_PRINTK=y





# SPDX-License-Identifier: Apache-2.0

#CONFIG_BOARD_UT_CORE=y

# enable uart driver
#CONFIG_CONSOLE=n
#CONFIG_UART_CONSOLE=n
#CONFIG_SERIAL=n

# enable GPIO
#CONFIG_GPIO=y

# console
#CONFIG_CONSOLE=y
#CONFIG_UART_CONSOLE=y

# Enable MPU
#CONFIG_ARM_MPU=y

# Enable HW stack protection
#CONFIG_HW_STACK_PROTECTION=y



# Keep it simple: internal HSI only
#CONFIG_CLOCK_CONTROL=y
#CONFIG_CLOCK_CONTROL_STM32_CUBE=y

# Disable PLL/HSE/LSE expectations
#CONFIG_STM32_HSE_CLOCK=0
#CONFIG_STM32_LSE_CLOCK=0

# If enabled anywhere, turn off USB clocking assumptions
#CONFIG_USB_DEVICE_STACK=n
#CONFIG_USB=n

# If enabled, HSI48 can cause waits; disable if you don't need it right now
#CONFIG_STM32_HSI48=n
```
