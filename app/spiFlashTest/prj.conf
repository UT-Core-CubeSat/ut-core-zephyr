## CMakeLists.txt
```
cmake_minimum_required(VERSION 3.20.0)
find_package(Zephyr REQUIRED HINTS $ENV{ZEPHYR_BASE})
project(spi_fram_tmr)
target_sources(app PRIVATE src/fram_tmr.c)
```

## prj.conf
```kconfig
CONFIG_FLASH=y
CONFIG_FLASH_MAP=y
CONFIG_MPU_ALLOW_FLASH_WRITE=y   # usually not needed, but harmless if you later self-program
CONFIG_SPI_STM32_DMA=n


CONFIG_GPIO=y
CONFIG_CAN=n
CONFIG_SPI=y
CONFIG_SPI_STM32=y
CONFIG_CAN_STM32_FDCAN=n

# --- LOGGING & CONSOLE SETUP (RTT) ---
# 1. Force the Console subsystem to stay ON
CONFIG_CONSOLE=y
CONFIG_STDOUT_CONSOLE=y

# 2. Configure RTT as the backend
CONFIG_USE_SEGGER_RTT=y
CONFIG_RTT_CONSOLE=y

# 3. Disable UART/Serial to prevent conflicts
CONFIG_UART_CONSOLE=n
CONFIG_SERIAL=n

# 4. Connect Printk and Logging to RTT
CONFIG_PRINTK=y
CONFIG_LOG=y
CONFIG_LOG_BACKEND_RTT=y
CONFIG_LOG_BACKEND_UART=n
CONFIG_LOG_MODE_IMMEDIATE=y

# --- SEMIHOSTING SETUP ---
CONFIG_SEMIHOST=n
CONFIG_SEMIHOST_CONSOLE=n

# --- hard disable PM / idle sleep ---
CONFIG_PM=n
CONFIG_PM_DEVICE=n
CONFIG_PM_DEVICE_RUNTIME=n

# Optional: if you have tickless enabled somewhere
CONFIG_TICKLESS_KERNEL=n
```

## src/main.c
```c
/*
 * CY15x104QN FRAM diagnostic on SPI2 (Zephyr / STM32U5)
 *
 * Key changes vs your original:
 *  - WRITE uses spi_transceive (full duplex) so CS handling is identical to your working cmds
 *  - Drop speed to 1 MHz for stability (ramp later)
 *  - Read SR twice (checks for bit flips)
 *  - Read data twice (checks for transfer corruption)
 *
 * IMPORTANT build-side fix (recommended):
 *  - Disable SPI DMA for STM32U5 (see prj.conf below)
 */

 #include <zephyr/kernel.h>
 #include <zephyr/device.h>
 #include <zephyr/drivers/spi.h>
 #include <zephyr/drivers/gpio.h>
 #include <zephyr/sys/printk.h>
 #include <string.h>
 #include <errno.h>
 
 #define SPI_BUS_NODE    DT_NODELABEL(spi2)
 
 #define TEST_BUF_SIZE   4096
 
 /* WP pin: PB5 (optional) */
 #define WP_PORT_NODE    DT_NODELABEL(gpiob)
 #define WP_PIN          5
 
 /* Bring-up speed (raise later) */
 #define FRAM_SPI_HZ     1000000U
 
 static const struct device *spi_bus = DEVICE_DT_GET(SPI_BUS_NODE);
 static const struct device *wp_port = DEVICE_DT_GET(WP_PORT_NODE);
 
 static const struct gpio_dt_spec cs_gpio =
     GPIO_DT_SPEC_GET_BY_IDX(SPI_BUS_NODE, cs_gpios, 0);
 
 static struct spi_config spi_cfg = {
     .frequency = FRAM_SPI_HZ,
     .operation = SPI_OP_MODE_MASTER |
                  SPI_TRANSFER_MSB   |
                  SPI_WORD_SET(8)    |
                  SPI_MODE_CPOL      |
                  SPI_MODE_CPHA,       /* Mode 3 */
     .slave = 0,
     .cs = {
         .gpio = cs_gpio,
         .delay = 0,
         .cs_is_gpio = true,
     },
 };
 
 static uint8_t tx_buf[TEST_BUF_SIZE];
 static uint8_t rx_buf[TEST_BUF_SIZE];
 static uint8_t rx2_buf[TEST_BUF_SIZE];
 
 static uint8_t wr_tx[4 + TEST_BUF_SIZE];
 static uint8_t wr_rx[4 + TEST_BUF_SIZE];   /* dummy RX for full-duplex write */
 
 static uint8_t rd_tx[4 + TEST_BUF_SIZE];
 static uint8_t rd_rx[4 + TEST_BUF_SIZE];
 
 static int spi_txrx(const uint8_t *tx, size_t n, uint8_t *rx, size_t rn)
 {
     struct spi_buf tb = { .buf = (void *)tx, .len = n };
     struct spi_buf_set ts = { .buffers = &tb, .count = 1 };
 
     struct spi_buf rb = { .buf = rx, .len = rn };
     struct spi_buf_set rs = { .buffers = &rb, .count = 1 };
 
     int rc = spi_transceive(spi_bus, &spi_cfg, &ts, &rs);
 
     /* Force CS high / release bus */
     spi_release(spi_bus, &spi_cfg);
 
     /* Small guard time (helps if driver deassert is edgy) */
     k_busy_wait(2);
 
     return rc;
 }
 
 static int fram_cmd(uint8_t opcode)
 {
     uint8_t tx[1] = { opcode };
     uint8_t rx[1] = { 0 };
     return spi_txrx(tx, sizeof(tx), rx, sizeof(rx));
 }
 
 static int fram_rdsr(uint8_t *sr_out)
 {
     uint8_t tx[2] = { 0x05, 0x00 };
     uint8_t rx[2] = { 0 };
 
     int rc = spi_txrx(tx, sizeof(tx), rx, sizeof(rx));
     if (rc == 0) {
         *sr_out = rx[1];
     }
     return rc;
 }
 
 static int fram_rdid(uint8_t id_out[9])
 {
     uint8_t tx[10] = { 0 };
     uint8_t rx[10] = { 0 };
     tx[0] = 0x9F;
 
     int rc = spi_txrx(tx, sizeof(tx), rx, sizeof(rx));
     if (rc == 0) {
         memcpy(id_out, &rx[1], 9);
     }
     return rc;
 }
 
 /* WREN, and read SR twice to confirm stability */
 static int fram_wren(void)
 {
     int rc = fram_cmd(0x06);
     if (rc) {
         printk("  WREN SPI error: rc=%d\n", rc);
         return rc;
     }
 
     uint8_t sr1 = 0, sr2 = 0;
     rc = fram_rdsr(&sr1);
     if (rc) return rc;
     rc = fram_rdsr(&sr2);
     if (rc) return rc;
 
     printk("  SR after WREN: 0x%02X / 0x%02X\n", sr1, sr2);
 
     if (!(sr1 & 0x02) || !(sr2 & 0x02)) {
         printk("  WEL not set (or unstable) after WREN!\n");
         return -EIO;
     }
 
     return 0;
 }
 
 /*
  * WRITE FIX: use transceive, not spi_write.
  * This removes “write-only CS weirdness” as a variable.
  */
 static int fram_write(uint32_t addr, const uint8_t *data, size_t len)
 {
     if (len > TEST_BUF_SIZE) return -EINVAL;
 
     size_t total = 4 + len;
     wr_tx[0] = 0x02;
     wr_tx[1] = (addr >> 16) & 0xFF;
     wr_tx[2] = (addr >> 8)  & 0xFF;
     wr_tx[3] = (addr)       & 0xFF;
     memcpy(&wr_tx[4], data, len);
 
     memset(wr_rx, 0, total);
 
     return spi_txrx(wr_tx, total, wr_rx, total);
 }
 
 static int fram_read(uint32_t addr, uint8_t *data, size_t len)
 {
     if (len > TEST_BUF_SIZE) return -EINVAL;
 
     size_t total = 4 + len;
 
     memset(rd_tx, 0, total);
     memset(rd_rx, 0xCC, total);
 
     rd_tx[0] = 0x03;
     rd_tx[1] = (addr >> 16) & 0xFF;
     rd_tx[2] = (addr >> 8)  & 0xFF;
     rd_tx[3] = (addr)       & 0xFF;
 
     int rc = spi_txrx(rd_tx, total, rd_rx, total);
     if (rc == 0) {
         memcpy(data, &rd_rx[4], len);
     }
     return rc;
 }
 
 int main(void)
 {
     printk("\n========================================\n");
     printk("FRAM Diagnostic (CY15x104QN) @ %u Hz\n", (unsigned)FRAM_SPI_HZ);
     printk("========================================\n\n");
 
     if (!device_is_ready(spi_bus)) {
         printk("ERROR: SPI bus not ready\n");
         return 0;
     }
     if (!gpio_is_ready_dt(&cs_gpio)) {
         printk("ERROR: CS GPIO not ready\n");
         return 0;
     }
 
     printk("SPI bus ready. CS: port=%s pin=%d\n", cs_gpio.port->name, cs_gpio.pin);
 
     if (device_is_ready(wp_port)) {
         gpio_pin_configure(wp_port, WP_PIN, GPIO_OUTPUT_HIGH);
         printk("WP pin (PB5) driven HIGH\n\n");
     }
 
     /* RDID */
     printk("[1] RDID\n");
     uint8_t id[9] = {0};
     int rc = fram_rdid(id);
     printk("  rc=%d ID:", rc);
     for (int i = 0; i < 9; i++) printk(" %02X", id[i]);
     printk("\n\n");
 
     /* RDSR twice */
     printk("[2] RDSR\n");
     uint8_t sr1=0, sr2=0;
     rc = fram_rdsr(&sr1);
     rc |= fram_rdsr(&sr2);
     printk("  rc=%d SR1=0x%02X SR2=0x%02X (WEL=%d/%d)\n\n",
            rc, sr1, sr2, (sr1>>1)&1, (sr2>>1)&1);
 
     /* Write/read diagnostic */
     const uint32_t addr = 0x002000;
     const size_t len = 16;
 
     printk("[3] DIAGNOSTIC: write %u bytes @ 0x%06X\n", (unsigned)len, addr);
 
     for (size_t i = 0; i < len; i++) tx_buf[i] = (uint8_t)(0xA0 + i);
 
     printk("  TX:");
     for (size_t i = 0; i < len; i++) printk(" %02X", tx_buf[i]);
     printk("\n");
 
     rc = fram_wren();
     if (rc) {
         printk("  WREN FAILED: rc=%d\n", rc);
         goto done;
     }
 
     rc = fram_write(addr, tx_buf, len);
     printk("  WRITE rc=%d\n", rc);
 
     /* Read SR twice after write */
     sr1 = sr2 = 0;
     fram_rdsr(&sr1);
     fram_rdsr(&sr2);
     printk("  SR after WRITE: 0x%02X / 0x%02X (WEL=%d/%d)\n",
            sr1, sr2, (sr1>>1)&1, (sr2>>1)&1);
 
     /* Read twice */
     memset(rx_buf,  0xCC, len);
     memset(rx2_buf, 0xDD, len);
 
     rc = fram_read(addr, rx_buf, len);
     printk("  READ1 rc=%d\n", rc);
 
     rc = fram_read(addr, rx2_buf, len);
     printk("  READ2 rc=%d\n", rc);
 
     printk("  RX1:");
     for (size_t i = 0; i < len; i++) printk(" %02X", rx_buf[i]);
     printk("\n");
 
     printk("  RX2:");
     for (size_t i = 0; i < len; i++) printk(" %02X", rx2_buf[i]);
     printk("\n");
 
     printk("  MATCH1: %s\n", (memcmp(tx_buf, rx_buf,  len) == 0) ? "YES" : "NO");
     printk("  MATCH2: %s\n", (memcmp(tx_buf, rx2_buf, len) == 0) ? "YES" : "NO");
     printk("  RX1==RX2: %s\n", (memcmp(rx_buf, rx2_buf, len) == 0) ? "YES" : "NO");
 
 done:
     printk("\n========================================\n");
     printk("Done\n");
     printk("========================================\n");
 
     while (1) k_msleep(2000);
 }
 
```

## src/flash_provision_tmr.h
```c
/*
 * flash_provision_tmr.h — Flash-to-FRAM TMR provisioning and scrub layer
 *
 * Builds on top of fram_tmr.h to provide:
 *   - One-time provisioning:  MCU internal flash  ->  FRAM x3 (TMR)
 *   - Periodic scrubbing:    vote + repair FRAMs, compare against flash
 *
 * Architecture:
 *   The MCU internal flash is the initial source of truth (it holds
 *   the firmware image at power-on).  After provisioning, the three
 *   FRAM copies become the golden reference.  TMR voting keeps them
 *   consistent.  If internal flash is later found to disagree with
 *   the FRAM majority, flash is the one that's wrong.
 *
 * FRAM address mapping:
 *   1:1 with flash offset.  Flash offset 0 -> FRAM address 0.
 *   The firmware image must fit within FRAM_SIZE (512 KiB).
 */

#ifndef FLASH_PROVISION_TMR_H_
#define FLASH_PROVISION_TMR_H_

#include "fram_tmr.h"
#include <zephyr/drivers/flash.h>

/* =========================================================================
 * Linker symbols — boundaries of the firmware image in flash
 * ========================================================================= */

extern char __rom_region_start[];
extern char __rom_region_end[];

/* =========================================================================
 * Tunables
 * ========================================================================= */

#define FLASH_TMR_CHUNK_SZ       32u
#define SCRUB_YIELD_INTERVAL     16u

/* =========================================================================
 * Helpers
 * ========================================================================= */

static inline size_t flash_tmr_fw_size(void)
{
    return (size_t)(__rom_region_end - __rom_region_start);
}

/* =========================================================================
 * Provision:  read MCU flash  ->  TMR write to FRAM A, B, C
 *
 * Call once at boot.  After this returns successfully the three
 * FRAMs hold identical copies of the firmware image and become
 * the golden reference.
 * ========================================================================= */

static int flash_tmr_provision(const struct device *flash_dev,
                               struct fram_dev *fa,
                               struct fram_dev *fb,
                               struct fram_dev *fc)
{
    size_t fw_size = flash_tmr_fw_size();
    uint8_t buf[FLASH_TMR_CHUNK_SZ];

    if (!device_is_ready(flash_dev)) {
        printk("PROVISION: flash device not ready\n");
        return -ENODEV;
    }

    if (fw_size == 0) {
        printk("PROVISION: firmware size is 0 — linker symbols wrong?\n");
        return -EINVAL;
    }

    if (fw_size > FRAM_SIZE) {
        printk("PROVISION: firmware (%u B) exceeds FRAM capacity (%u B)\n",
               (unsigned)fw_size, (unsigned)FRAM_SIZE);
        return -ENOMEM;
    }

    printk("PROVISION: %u bytes  flash -> FRAM x3\n", (unsigned)fw_size);

    for (size_t off = 0; off < fw_size; off += FLASH_TMR_CHUNK_SZ) {
        size_t chunk = (fw_size - off < FLASH_TMR_CHUNK_SZ)
                     ? (fw_size - off)
                     : FLASH_TMR_CHUNK_SZ;

        int err = flash_read(flash_dev, off, buf, chunk);
        if (err) {
            printk("PROVISION: flash_read @ 0x%06x err=%d\n",
                   (unsigned)off, err);
            return err;
        }

        err = tmr_fram_write(fa, fb, fc, (uint32_t)off, buf, chunk);
        if (err) {
            printk("PROVISION: tmr_write @ 0x%06x err=%d\n",
                   (unsigned)off, err);
            return err;
        }

        if ((off & 0xFFF) == 0) {
            printk("  0x%06x / 0x%06x\n", (unsigned)off, (unsigned)fw_size);
        }
    }

    printk("PROVISION: complete\n");
    return 0;
}

/* =========================================================================
 * Scrub result
 * ========================================================================= */

struct flash_tmr_scrub_result {
    uint32_t chunks_checked;
    uint32_t flash_mismatches;
};

/* =========================================================================
 * Scrub:  FRAM vote + repair,  then compare flash against FRAM majority
 *
 * Two things happen in each chunk iteration:
 *
 *   1. tmr_fram_read() reads all 3 FRAMs, votes, and auto-repairs
 *      the odd chip out (FRAM-to-FRAM scrub).
 *
 *   2. The voted FRAM result is compared against the MCU internal
 *      flash.  Mismatches are reported — the FRAM majority is
 *      considered correct and flash is the suspect.
 *
 * Returns 0 on success, negative errno on hard failure.
 * ========================================================================= */

static int flash_tmr_scrub(const struct device *flash_dev,
                           struct fram_dev *fa,
                           struct fram_dev *fb,
                           struct fram_dev *fc,
                           struct flash_tmr_scrub_result *result)
{
    size_t fw_size = flash_tmr_fw_size();
    uint8_t fram_buf[FLASH_TMR_CHUNK_SZ];
    uint8_t flash_buf[FLASH_TMR_CHUNK_SZ];

    if (result) {
        memset(result, 0, sizeof(*result));
    }

    uint32_t yield_ctr = 0;

    for (size_t off = 0; off < fw_size; off += FLASH_TMR_CHUNK_SZ) {
        size_t chunk = (fw_size - off < FLASH_TMR_CHUNK_SZ)
                     ? (fw_size - off)
                     : FLASH_TMR_CHUNK_SZ;

        /* FRAM majority vote (repairs divergent chip internally) */
        int err = tmr_fram_read(fa, fb, fc, (uint32_t)off, fram_buf, chunk);
        if (err) {
            printk("SCRUB: FRAM read error @ 0x%06x: %d\n",
                   (unsigned)off, err);
            return err;
        }

        /* read the same region from MCU internal flash */
        err = flash_read(flash_dev, off, flash_buf, chunk);
        if (err) {
            printk("SCRUB: flash_read error @ 0x%06x: %d\n",
                   (unsigned)off, err);
            return err;
        }

        if (memcmp(flash_buf, fram_buf, chunk) != 0) {
            printk("SCRUB: flash != FRAM @ 0x%06x  (FRAM is golden)\n",
                   (unsigned)off);
            if (result) {
                result->flash_mismatches++;
            }
        }

        if (result) {
            result->chunks_checked++;
        }

        if (++yield_ctr % SCRUB_YIELD_INTERVAL == 0) {
            k_yield();
        }
    }

    return 0;
}

#endif /* FLASH_PROVISION_TMR_H_ */
```

## src/flash_tmr.c
```c
/*
 * flash_tmr.c — Flash-to-FRAM TMR application
 *
 * On boot:
 *   1. Reads the MCU internal flash (the running firmware image)
 *   2. TMR-writes it to all 3 FRAM chips (provisioning)
 *   3. Verifies the provisioned data matches flash
 *
 * Then runs a periodic scrub loop:
 *   - Votes across the 3 FRAMs and repairs any divergent chip
 *   - Compares the FRAM majority against internal flash
 *   - Reports any mismatches (FRAM is the golden reference)
 */

#include "flash_tmr.h"

/* =========================================================================
 * Devicetree bindings
 * ========================================================================= */

#define SPI_BUS_NODE DT_NODELABEL(spi2)
#define SCOPE_NODE   DT_ALIAS(led0)

static const struct device *spi_bus = DEVICE_DT_GET(SPI_BUS_NODE);

static const struct gpio_dt_spec cs_gpio_0 =
    GPIO_DT_SPEC_GET_BY_IDX(SPI_BUS_NODE, cs_gpios, 0);
static const struct gpio_dt_spec cs_gpio_1 =
    GPIO_DT_SPEC_GET_BY_IDX(SPI_BUS_NODE, cs_gpios, 1);
static const struct gpio_dt_spec cs_gpio_2 =
    GPIO_DT_SPEC_GET_BY_IDX(SPI_BUS_NODE, cs_gpios, 2);

static const struct gpio_dt_spec scope_pin =
    GPIO_DT_SPEC_GET(SCOPE_NODE, gpios);

/* =========================================================================
 * 3 physical FRAM device instances
 * ========================================================================= */

static struct fram_dev fram_a;
static struct fram_dev fram_b;
static struct fram_dev fram_c;

static void init_fram_dev(struct fram_dev *dev,
                          const char *name,
                          const struct gpio_dt_spec *cs)
{
    dev->name    = name;
    dev->spi_bus = spi_bus;

    dev->spi_cfg.frequency = 400000;
    dev->spi_cfg.operation = SPI_OP_MODE_MASTER |
                             SPI_TRANSFER_MSB   |
                             SPI_WORD_SET(8);
    dev->spi_cfg.slave     = 0;
    dev->spi_cfg.cs.gpio       = *cs;
    dev->spi_cfg.cs.delay      = 1;
    dev->spi_cfg.cs.cs_is_gpio = true;
}

/* =========================================================================
 * Configuration
 * ========================================================================= */

#define SCRUB_INTERVAL_MS  10000u
#define INJECT_EVERY_N     3u        /* inject a fault every N scrub cycles */
#define INJECT_ADDR        0x0200u   /* FRAM address to corrupt */

/* =========================================================================
 * Fault injection — simulate a single-bit flip on one FRAM chip
 *
 * Bypasses TMR and writes directly to one chip so the other two
 * still hold the correct data.  The next scrub should detect the
 * divergence, outvote the bad chip, and repair it.
 * ========================================================================= */

static int inject_bitflip(struct fram_dev *target, uint32_t addr)
{
    uint8_t original;

    int err = fram_read(target, addr, &original, 1);
    if (err) {
        return err;
    }

    uint8_t corrupted = original ^ 0x01;

    err = fram_wren(target);
    if (err) {
        return err;
    }
    k_busy_wait(1);

    err = fram_write_fixed(target, addr, &corrupted, 1);
    if (err) {
        return err;
    }

    printk("INJECT: flipped bit0 on %s @ 0x%06x  (0x%02X -> 0x%02X)\n",
           target->name, (unsigned)addr, original, corrupted);
    return 0;
}

/* =========================================================================
 * main
 * ========================================================================= */

int main(void)
{
    k_busy_wait(1000);

    /* ---- hardware readiness ---- */

    if (!device_is_ready(spi_bus)) {
        printk("SPI bus not ready\n");
        return 0;
    }

    if (!gpio_is_ready_dt(&cs_gpio_0) ||
        !gpio_is_ready_dt(&cs_gpio_1) ||
        !gpio_is_ready_dt(&cs_gpio_2)) {
        printk("FRAM CS GPIOs not ready\n");
        return 0;
    }

    if (!gpio_is_ready_dt(&scope_pin)) {
        printk("Scope GPIO not ready\n");
        return 0;
    }

    gpio_pin_configure_dt(&scope_pin, GPIO_OUTPUT_INACTIVE);

    /* ---- init 3 FRAM devices ---- */

    init_fram_dev(&fram_a, "FRAM_A", &cs_gpio_0);
    init_fram_dev(&fram_b, "FRAM_B", &cs_gpio_1);
    init_fram_dev(&fram_c, "FRAM_C", &cs_gpio_2);

    printk("Flash-TMR: FRAMs initialised  A(CS0) B(CS1) C(CS2)\n");

    /* ---- RDID sanity check ---- */

    uint8_t id[FRAM_RDID_LEN];
    struct fram_dev *chips[] = { &fram_a, &fram_b, &fram_c };
    const char *labels[]     = { "A", "B", "C" };

    for (int i = 0; i < 3; i++) {
        int err = fram_rdid(chips[i], id);
        if (err) {
            printk("RDID FRAM_%s: FAILED err=%d\n", labels[i], err);
        } else {
            printk("RDID FRAM_%s:", labels[i]);
            for (int j = 0; j < FRAM_RDID_LEN; j++) {
                printk(" %02X", id[j]);
            }
            printk("\n");
        }
    }

    /* ---- get internal flash device ---- */

    const struct device *flash_dev = DEVICE_DT_GET(DT_PARENT(DT_CHOSEN(zephyr_flash)));

    printk("Firmware size: %u bytes\n", (unsigned)flash_tmr_fw_size());

    /* ---- Step 1:  provision  flash -> FRAM x3 ---- */

    gpio_pin_set_dt(&scope_pin, 1);
    int err = flash_tmr_provision(flash_dev, &fram_a, &fram_b, &fram_c);
    gpio_pin_set_dt(&scope_pin, 0);

    if (err) {
        printk("PROVISIONING FAILED: %d — halting\n", err);
        return 0;
    }

    /* ---- Step 2:  verify provision (first scrub pass) ---- */

    struct flash_tmr_scrub_result result;
    err = flash_tmr_scrub(flash_dev, &fram_a, &fram_b, &fram_c, &result);

    if (err) {
        printk("POST-PROVISION VERIFY FAILED: %d — halting\n", err);
        return 0;
    }

    if (result.flash_mismatches > 0) {
        printk("POST-PROVISION VERIFY: %u mismatches — halting\n",
               result.flash_mismatches);
        return 0;
    }

    printk("POST-PROVISION VERIFY: OK  (%u chunks)\n", result.chunks_checked);
    printk("Entering scrub loop (interval %u ms)...\n",
           (unsigned)SCRUB_INTERVAL_MS);

    /* ---- Step 3:  periodic scrub  (FRAM is golden) ---- */

    uint32_t scrub_count = 0;

    struct fram_dev *fault_targets[] = { &fram_a, &fram_b, &fram_c };

    while (1) {
        k_msleep(SCRUB_INTERVAL_MS);
        scrub_count++;

        /* inject a fault before the scrub so the scrub has to catch it */
        if (scrub_count % INJECT_EVERY_N == 0) {
            int target_idx = (scrub_count / INJECT_EVERY_N) % 3;
            inject_bitflip(fault_targets[target_idx], INJECT_ADDR);
        }

        gpio_pin_set_dt(&scope_pin, 1);
        err = flash_tmr_scrub(flash_dev, &fram_a, &fram_b, &fram_c, &result);
        gpio_pin_set_dt(&scope_pin, 0);

        if (err) {
            printk("SCRUB #%u ERROR: %d\n", scrub_count, err);
        } else if (result.flash_mismatches > 0) {
            printk("SCRUB #%u: %u flash mismatches detected  (%u chunks)\n",
                   scrub_count, result.flash_mismatches, result.chunks_checked);
        } else {
            printk("SCRUB #%u: OK  (%u chunks)\n",
                   scrub_count, result.chunks_checked);
        }
    }
}
```

## src/flash_tmr.h
```c
/*
 * flash_tmr.h — Flash-to-FRAM TMR provisioning and scrub layer
 *
 * Builds on top of fram_tmr.h to provide:
 *   - One-time provisioning:  MCU internal flash  ->  FRAM x3 (TMR)
 *   - Periodic scrubbing:    vote + repair FRAMs, compare against flash
 *
 * Architecture:
 *   The MCU internal flash is the initial source of truth (it holds
 *   the firmware image at power-on).  After provisioning, the three
 *   FRAM copies become the golden reference.  TMR voting keeps them
 *   consistent.  If internal flash is later found to disagree with
 *   the FRAM majority, flash is the one that's wrong.
 *
 * FRAM address mapping:
 *   1:1 with flash offset.  Flash offset 0 -> FRAM address 0.
 *   The firmware image must fit within FRAM_SIZE (512 KiB).
 */

#ifndef FLASH_TMR_H_
#define FLASH_TMR_H_

#include "fram_tmr.h"
#include <zephyr/drivers/flash.h>

/* =========================================================================
 * Linker symbols — boundaries of the firmware image in flash
 * ========================================================================= */

extern char __rom_region_start[];
extern char __rom_region_end[];

/* =========================================================================
 * Tunables
 * ========================================================================= */

#define FLASH_TMR_CHUNK_SZ  32u

/* =========================================================================
 * Helpers
 * ========================================================================= */

static inline size_t flash_tmr_fw_size(void)
{
    return (size_t)(__rom_region_end - __rom_region_start);
}

/* =========================================================================
 * Provision:  read MCU flash  ->  TMR write to FRAM A, B, C
 *
 * Call once at boot.  After this returns successfully the three
 * FRAMs hold identical copies of the firmware image and become
 * the golden reference.
 * ========================================================================= */

static int flash_tmr_provision(const struct device *flash_dev,
                               struct fram_dev *fa,
                               struct fram_dev *fb,
                               struct fram_dev *fc)
{
    size_t fw_size = flash_tmr_fw_size();
    uint8_t buf[FLASH_TMR_CHUNK_SZ];

    if (!device_is_ready(flash_dev)) {
        printk("PROVISION: flash device not ready\n");
        return -ENODEV;
    }

    if (fw_size == 0) {
        printk("PROVISION: firmware size is 0 — linker symbols wrong?\n");
        return -EINVAL;
    }

    if (fw_size > FRAM_SIZE) {
        printk("PROVISION: firmware (%u B) exceeds FRAM capacity (%u B)\n",
               (unsigned)fw_size, (unsigned)FRAM_SIZE);
        return -ENOMEM;
    }

    printk("PROVISION: %u bytes  flash -> FRAM x3\n", (unsigned)fw_size);

    for (size_t off = 0; off < fw_size; off += FLASH_TMR_CHUNK_SZ) {
        size_t chunk = (fw_size - off < FLASH_TMR_CHUNK_SZ)
                     ? (fw_size - off)
                     : FLASH_TMR_CHUNK_SZ;

        int err = flash_read(flash_dev, off, buf, chunk);
        if (err) {
            printk("PROVISION: flash_read @ 0x%06x err=%d\n",
                   (unsigned)off, err);
            return err;
        }

        err = tmr_fram_write(fa, fb, fc, (uint32_t)off, buf, chunk);
        if (err) {
            printk("PROVISION: tmr_write @ 0x%06x err=%d\n",
                   (unsigned)off, err);
            return err;
        }

        if ((off & 0xFFF) == 0) {
            printk("  0x%06x / 0x%06x\n", (unsigned)off, (unsigned)fw_size);
        }
    }

    printk("PROVISION: complete\n");
    return 0;
}

/* =========================================================================
 * Scrub result
 * ========================================================================= */

struct flash_tmr_scrub_result {
    uint32_t chunks_checked;
    uint32_t flash_mismatches;
};

/* =========================================================================
 * Scrub:  FRAM vote + repair,  then compare flash against FRAM majority
 *
 * Two things happen in each chunk iteration:
 *
 *   1. tmr_fram_read() reads all 3 FRAMs, votes, and auto-repairs
 *      the odd chip out (FRAM-to-FRAM scrub).
 *
 *   2. The voted FRAM result is compared against the MCU internal
 *      flash.  Mismatches are reported — the FRAM majority is
 *      considered correct and flash is the suspect.
 *
 * Returns 0 on success, negative errno on hard failure.
 * ========================================================================= */

static int flash_tmr_scrub(const struct device *flash_dev,
                           struct fram_dev *fa,
                           struct fram_dev *fb,
                           struct fram_dev *fc,
                           struct flash_tmr_scrub_result *result)
{
    size_t fw_size = flash_tmr_fw_size();
    uint8_t fram_buf[FLASH_TMR_CHUNK_SZ];
    uint8_t flash_buf[FLASH_TMR_CHUNK_SZ];

    if (result) {
        memset(result, 0, sizeof(*result));
    }

    for (size_t off = 0; off < fw_size; off += FLASH_TMR_CHUNK_SZ) {
        size_t chunk = (fw_size - off < FLASH_TMR_CHUNK_SZ)
                     ? (fw_size - off)
                     : FLASH_TMR_CHUNK_SZ;

        /* FRAM majority vote (repairs divergent chip internally) */
        int err = tmr_fram_read(fa, fb, fc, (uint32_t)off, fram_buf, chunk);
        if (err) {
            printk("SCRUB: FRAM read error @ 0x%06x: %d\n",
                   (unsigned)off, err);
            return err;
        }

        /* read the same region from MCU internal flash */
        err = flash_read(flash_dev, off, flash_buf, chunk);
        if (err) {
            printk("SCRUB: flash_read error @ 0x%06x: %d\n",
                   (unsigned)off, err);
            return err;
        }

        if (memcmp(flash_buf, fram_buf, chunk) != 0) {
            printk("SCRUB: flash != FRAM @ 0x%06x  (FRAM is golden)\n",
                   (unsigned)off);
            if (result) {
                result->flash_mismatches++;
            }
        }

        if (result) {
            result->chunks_checked++;
        }
    }

    return 0;
}

#endif /* FLASH_TMR_H_ */
```

## src/fram_tmr.h
```c
/*
 * fram_tmr.h / fram_tmr.c style implementation
 *
 * What this gives you:
 *  - raw per-chip FRAM read/write helpers
 *  - verified per-chip writes
 *  - TMR write to 3 physical FRAM chips
 *  - TMR read with whole-buffer majority vote
 *  - optional single-chip repair on read
 *
 * Assumptions:
 *  - all 3 FRAMs are on the same SPI bus
 *  - each FRAM has its own chip-select GPIO
 *  - same opcode set / same memory map on each chip
 *  - same max size on each chip
 *
 * Notes:
 *  - this intentionally does NOT include main()
 *  - this intentionally does NOT include random test code
 *  - this is the reusable layer you build on top of
 */

 #include <zephyr/kernel.h>
 #include <zephyr/device.h>
 #include <zephyr/drivers/spi.h>
 #include <zephyr/drivers/gpio.h>
 #include <zephyr/sys/printk.h>
 #include <zephyr/cache.h>
 
 #include <string.h>
 #include <stdbool.h>
 #include <stdint.h>
 #include <errno.h>
 
 /* =========================
  * Tunables
  * ========================= */
 
 #define FRAM_SIZE             0x80000u   /* 512 KiB */
 #define FRAM_RW_MAX_LEN       256u       /* raw transaction max payload */
 #define FRAM_VERIFY_CHUNK_SZ  16u
 #define FRAM_MAX_RETRIES      5
 
 #define TMR_READ_CHUNK_SZ     32u
 #define TMR_ENABLE_REPAIR     1
 
 /* =========================
  * FRAM device abstraction
  * ========================= */
 
 struct fram_dev {
     const char *name;
     const struct device *spi_bus;
     struct spi_config spi_cfg;
 };
 
 /* =========================
  * Helpers
  * ========================= */
 
 static inline void addr_to_3b(uint32_t addr, uint8_t a[3])
 {
     a[0] = (addr >> 16) & 0xFF;
     a[1] = (addr >> 8)  & 0xFF;
     a[2] = (addr >> 0)  & 0xFF;
 }
 
 /* =========================
  * Raw single-chip helpers
  * ========================= */
 
 /*
  * Send WREN to one FRAM chip.
  * Must be called before every write transaction.
  */
 static int fram_wren(struct fram_dev *dev)
 {
     static uint8_t cmd[4] __aligned(32) = { 0x06 };
 
     sys_cache_data_flush_range(cmd, sizeof(cmd));
 
     struct spi_buf b = {
         .buf = cmd,
         .len = 1
     };
     struct spi_buf_set s = {
         .buffers = &b,
         .count = 1
     };
 
     return spi_write(dev->spi_bus, &dev->spi_cfg, &s);
 }
 
 /*
  * Raw write to one FRAM chip.
  * No verification here. Just pushes bytes.
  *
  * len must be <= FRAM_RW_MAX_LEN.
  */
 static int fram_write_fixed(struct fram_dev *dev,
                             uint32_t addr,
                             const uint8_t *data,
                             size_t len)
 {
     static uint8_t txbuf[4 + FRAM_RW_MAX_LEN] __aligned(32);
     uint8_t a[3];
 
     if (len > FRAM_RW_MAX_LEN) {
         return -EINVAL;
     }
 
     addr_to_3b(addr, a);
 
     txbuf[0] = 0x02;   /* WRITE */
     txbuf[1] = a[0];
     txbuf[2] = a[1];
     txbuf[3] = a[2];
     memcpy(&txbuf[4], data, len);
 
     sys_cache_data_flush_range(txbuf, 4 + len);
 
     struct spi_buf buf = {
         .buf = txbuf,
         .len = 4 + len
     };
     struct spi_buf_set tx = {
         .buffers = &buf,
         .count = 1
     };
 
     return spi_write(dev->spi_bus, &dev->spi_cfg, &tx);
 }
 
 /*
  * Raw read from one FRAM chip.
  * No voting, no CRC, no retry logic here.
  *
  * len must be <= FRAM_RW_MAX_LEN.
  */
 static int fram_read_fixed(struct fram_dev *dev,
                            uint32_t addr,
                            uint8_t *out,
                            size_t len)
 {
     static uint8_t tx[4 + FRAM_RW_MAX_LEN] __aligned(32);
     static uint8_t rx[4 + FRAM_RW_MAX_LEN] __aligned(32);
     uint8_t a[3];
 
     if (len > FRAM_RW_MAX_LEN) {
         return -EINVAL;
     }
 
     addr_to_3b(addr, a);
 
     memset(tx, 0x00, sizeof(tx));
     memset(rx, 0x00, sizeof(rx));
 
     tx[0] = 0x03;   /* READ */
     tx[1] = a[0];
     tx[2] = a[1];
     tx[3] = a[2];
 
     sys_cache_data_flush_range(tx, sizeof(tx));
     sys_cache_data_invd_range(rx, sizeof(rx));
 
     struct spi_buf txb = {
         .buf = tx,
         .len = 4 + len
     };
     struct spi_buf rxb = {
         .buf = rx,
         .len = 4 + len
     };
 
     struct spi_buf_set txs = {
         .buffers = &txb,
         .count = 1
     };
     struct spi_buf_set rxs = {
         .buffers = &rxb,
         .count = 1
     };
 
     int err = spi_transceive(dev->spi_bus, &dev->spi_cfg, &txs, &rxs);
     if (err) {
         return err;
     }
 
     sys_cache_data_invd_range(rx, sizeof(rx));
     memcpy(out, &rx[4], len);
 
     return 0;
 }
 
 /*
  * Optional chip ID read for one FRAM.
  * Handy for bring-up / sanity check.
  */
 #define FRAM_RDID_LEN 9
 
 static int fram_rdid(struct fram_dev *dev, uint8_t *out)
 {
     static uint8_t tx[1 + FRAM_RDID_LEN] __aligned(32);
     static uint8_t rx[1 + FRAM_RDID_LEN] __aligned(32);
 
     memset(tx, 0x00, sizeof(tx));
     memset(rx, 0x00, sizeof(rx));
 
     tx[0] = 0x9F;   /* RDID */
 
     sys_cache_data_flush_range(tx, sizeof(tx));
     sys_cache_data_invd_range(rx, sizeof(rx));
 
     struct spi_buf txb = {
         .buf = tx,
         .len = sizeof(tx)
     };
     struct spi_buf rxb = {
         .buf = rx,
         .len = sizeof(rx)
     };
 
     struct spi_buf_set txs = { .buffers = &txb, .count = 1 };
     struct spi_buf_set rxs = { .buffers = &rxb, .count = 1 };
 
     int err = spi_transceive(dev->spi_bus, &dev->spi_cfg, &txs, &rxs);
     if (err) {
         return err;
     }
 
     sys_cache_data_invd_range(rx, sizeof(rx));
     memcpy(out, &rx[1], FRAM_RDID_LEN);
 
     return 0;
 }
 
 /*
  * Verified write to one FRAM chip.
  *
  * This preserves the good part of your current code:
  * write a chunk, read it back, compare, retry if needed.
  */
 static int fram_write_verified(struct fram_dev *dev,
                                uint32_t addr,
                                const uint8_t *data,
                                size_t len)
 {
     if (len == 0) {
         return 0;
     }
 
     if (addr >= FRAM_SIZE || len > (FRAM_SIZE - addr)) {
         return -EINVAL;
     }
 
     uint8_t readback[FRAM_VERIFY_CHUNK_SZ];
 
     while (len > 0) {
         size_t chunk = (len < FRAM_VERIFY_CHUNK_SZ) ? len : FRAM_VERIFY_CHUNK_SZ;
         bool verified = false;
 
         for (int attempt = 0; attempt < FRAM_MAX_RETRIES; attempt++) {
             int err = fram_wren(dev);
             if (err) {
                 continue;
             }
 
             /* Tiny settle time between WREN and WRITE */
             k_busy_wait(1);
 
             err = fram_write_fixed(dev, addr, data, chunk);
             if (err) {
                 continue;
             }
 
             err = fram_read_fixed(dev, addr, readback, chunk);
             if (err) {
                 continue;
             }
 
             if (memcmp(data, readback, chunk) == 0) {
                 verified = true;
                 break;
             }
         }
 
         if (!verified) {
             return -EIO;
         }
 
         addr += chunk;
         data += chunk;
         len  -= chunk;
     }
 
     return 0;
 }
 
 /*
  * Plain read wrapper for one FRAM chip over multiple chunks.
  * Useful so higher layers do not need to care about the 256-byte raw limit.
  */
 static int fram_read(struct fram_dev *dev, uint32_t addr, uint8_t *out, size_t len)
 {
     if (len == 0) {
         return 0;
     }
 
     if (addr >= FRAM_SIZE || len > (FRAM_SIZE - addr)) {
         return -EINVAL;
     }
 
     while (len > 0) {
         size_t chunk = (len < FRAM_RW_MAX_LEN) ? len : FRAM_RW_MAX_LEN;
 
         int err = fram_read_fixed(dev, addr, out, chunk);
         if (err) {
             return err;
         }
 
         addr += chunk;
         out  += chunk;
         len  -= chunk;
     }
 
     return 0;
 }
 
 /* =========================
  * TMR voting helpers
  * ========================= */
 
 enum tmr_vote_result {
     TMR_VOTE_ALL_MATCH = 0,
     TMR_VOTE_AB_GOOD,
     TMR_VOTE_AC_GOOD,
     TMR_VOTE_BC_GOOD,
     TMR_VOTE_NO_MAJORITY,
 };
 
 static enum tmr_vote_result tmr_vote_whole_buffer(const uint8_t *a,
                                                   const uint8_t *b,
                                                   const uint8_t *c,
                                                   size_t len)
 {
     bool ab = (memcmp(a, b, len) == 0);
     bool ac = (memcmp(a, c, len) == 0);
     bool bc = (memcmp(b, c, len) == 0);
 
     if (ab && ac) {
         return TMR_VOTE_ALL_MATCH;
     }
     if (ab) {
         return TMR_VOTE_AB_GOOD;
     }
     if (ac) {
         return TMR_VOTE_AC_GOOD;
     }
     if (bc) {
         return TMR_VOTE_BC_GOOD;
     }
 
     return TMR_VOTE_NO_MAJORITY;
 }
 
 static const uint8_t *tmr_majority_buffer(const uint8_t *a,
                                           const uint8_t *b,
                                           const uint8_t *c,
                                           size_t len,
                                           enum tmr_vote_result *vote_out)
 {
     enum tmr_vote_result vote = tmr_vote_whole_buffer(a, b, c, len);
 
     if (vote_out) {
         *vote_out = vote;
     }
 
     switch (vote) {
     case TMR_VOTE_ALL_MATCH:
     case TMR_VOTE_AB_GOOD:
     case TMR_VOTE_AC_GOOD:
         return a;
 
     case TMR_VOTE_BC_GOOD:
         return b;
 
     case TMR_VOTE_NO_MAJORITY:
     default:
         return NULL;
     }
 }
 
 static int tmr_bad_index_from_vote(enum tmr_vote_result vote)
 {
     switch (vote) {
     case TMR_VOTE_AB_GOOD: return 2; /* C bad */
     case TMR_VOTE_AC_GOOD: return 1; /* B bad */
     case TMR_VOTE_BC_GOOD: return 0; /* A bad */
     default: return -1;
     }
 }
 
 /* =========================
  * Public TMR API
  * ========================= */
 
 /*
  * Write the same payload to all 3 FRAM chips.
  *
  * Strict policy:
  * all 3 must succeed or the call fails.
  */
 int tmr_fram_write(struct fram_dev *fram_a,
                    struct fram_dev *fram_b,
                    struct fram_dev *fram_c,
                    uint32_t addr,
                    const uint8_t *data,
                    size_t len)
 {
     if (!fram_a || !fram_b || !fram_c || !data) {
         return -EINVAL;
     }
 
     int err_a = fram_write_verified(fram_a, addr, data, len);
     int err_b = fram_write_verified(fram_b, addr, data, len);
     int err_c = fram_write_verified(fram_c, addr, data, len);
 
     if (err_a) {
         printk("TMR write failed on %s: %d\n", fram_a->name, err_a);
     }
     if (err_b) {
         printk("TMR write failed on %s: %d\n", fram_b->name, err_b);
     }
     if (err_c) {
         printk("TMR write failed on %s: %d\n", fram_c->name, err_c);
     }
 
     if (err_a || err_b || err_c) {
         return -EIO;
     }
 
     return 0;
 }
 
 /*
  * Read from all 3 FRAM chips, whole-buffer vote them,
  * and optionally repair the odd chip out.
  *
  * This starts simple:
  * - all 3 are read
  * - if 2 match, that copy wins
  * - if all 3 differ, fail
  *
  * Later you can upgrade this to CRC-backed records.
  */
 int tmr_fram_read(struct fram_dev *fram_a,
                   struct fram_dev *fram_b,
                   struct fram_dev *fram_c,
                   uint32_t addr,
                   uint8_t *out,
                   size_t len)
 {
     if (!fram_a || !fram_b || !fram_c || !out) {
         return -EINVAL;
     }
 
     uint8_t buf_a[TMR_READ_CHUNK_SZ];
     uint8_t buf_b[TMR_READ_CHUNK_SZ];
     uint8_t buf_c[TMR_READ_CHUNK_SZ];
 
     while (len > 0) {
         size_t chunk = (len < TMR_READ_CHUNK_SZ) ? len : TMR_READ_CHUNK_SZ;
 
         int err_a = fram_read(fram_a, addr, buf_a, chunk);
         int err_b = fram_read(fram_b, addr, buf_b, chunk);
         int err_c = fram_read(fram_c, addr, buf_c, chunk);
 
         if (err_a || err_b || err_c) {
             printk("TMR read raw failure at 0x%06x: A=%d B=%d C=%d\n",
                    (unsigned int)addr, err_a, err_b, err_c);
             return -EIO;
         }
 
         enum tmr_vote_result vote;
         const uint8_t *majority = tmr_majority_buffer(buf_a, buf_b, buf_c, chunk, &vote);
 
         if (majority == NULL) {
             printk("TMR read no majority at 0x%06x len=%u\n",
                    (unsigned int)addr, (unsigned int)chunk);
             return -EIO;
         }
 
         memcpy(out, majority, chunk);
 
 #if TMR_ENABLE_REPAIR
         int bad_idx = tmr_bad_index_from_vote(vote);
         if (bad_idx >= 0) {
             struct fram_dev *bad_dev =
                 (bad_idx == 0) ? fram_a :
                 (bad_idx == 1) ? fram_b : fram_c;
 
             printk("TMR: %s diverged at 0x%06x, repairing...\n",
                    bad_dev->name, (unsigned int)addr);

             int repair_err = fram_write_verified(bad_dev, addr, out, chunk);
             if (repair_err) {
                 printk("TMR: repair FAILED on %s at 0x%06x: %d\n",
                        bad_dev->name, (unsigned int)addr, repair_err);
             } else {
                 printk("TMR: %s repaired OK at 0x%06x\n",
                        bad_dev->name, (unsigned int)addr);
             }
         }
 #endif
 
         addr += chunk;
         out  += chunk;
         len  -= chunk;
     }
 
     return 0;
 }
 
 /*
  * Check whether all 3 FRAM chips contain exactly the same data
  * over a region. Good for bench testing and fault injection testing.
  */
 int tmr_fram_verify_all_equal(struct fram_dev *fram_a,
                               struct fram_dev *fram_b,
                               struct fram_dev *fram_c,
                               uint32_t addr,
                               size_t len)
 {
     if (!fram_a || !fram_b || !fram_c) {
         return -EINVAL;
     }
 
     uint8_t buf_a[TMR_READ_CHUNK_SZ];
     uint8_t buf_b[TMR_READ_CHUNK_SZ];
     uint8_t buf_c[TMR_READ_CHUNK_SZ];
 
     while (len > 0) {
         size_t chunk = (len < TMR_READ_CHUNK_SZ) ? len : TMR_READ_CHUNK_SZ;
 
         int err_a = fram_read(fram_a, addr, buf_a, chunk);
         int err_b = fram_read(fram_b, addr, buf_b, chunk);
         int err_c = fram_read(fram_c, addr, buf_c, chunk);
 
         if (err_a || err_b || err_c) {
             return -EIO;
         }
 
         if ((memcmp(buf_a, buf_b, chunk) != 0) ||
             (memcmp(buf_a, buf_c, chunk) != 0)) {
             return -EIO;
         }
 
         addr += chunk;
         len  -= chunk;
     }
 
     return 0;
 }
```
