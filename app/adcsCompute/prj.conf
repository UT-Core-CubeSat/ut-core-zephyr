## CMakeLists.txt
```
# SPDX-License-Identifier: Apache-2.0

cmake_minimum_required(VERSION 3.20.0)
find_package(Zephyr REQUIRED HINTS $ENV{ZEPHYR_BASE})
project(adcsCompute)

file(GLOB_RECURSE app_sources CONFIGURE_DEPENDS
  "${CMAKE_CURRENT_SOURCE_DIR}/src/*.c"
  "${CMAKE_CURRENT_SOURCE_DIR}/src/*.cpp"
)
target_sources(app PRIVATE ${app_sources})
target_include_directories(app PRIVATE "${CMAKE_CURRENT_SOURCE_DIR}/src")
```

## prj.conf
```kconfig
CONFIG_GPIO=y
CONFIG_CAN=y
CONFIG_CAN_STM32_FDCAN=y

# --- LOGGING & CONSOLE SETUP (RTT) ---
# 1. Force the Console subsystem to stay ON
CONFIG_CONSOLE=y
CONFIG_STDOUT_CONSOLE=y

# 2. Configure RTT as the backend
CONFIG_USE_SEGGER_RTT=y
CONFIG_RTT_CONSOLE=y

# 3. Disable UART/Serial to prevent conflicts
CONFIG_UART_CONSOLE=n
CONFIG_SERIAL=n

# 4. Connect Printk and Logging to RTT
CONFIG_PRINTK=y
CONFIG_LOG=y
CONFIG_LOG_BACKEND_RTT=y
CONFIG_LOG_BACKEND_UART=n
CONFIG_LOG_MODE_IMMEDIATE=y

# --- SEMIHOSTING SETUP ---
CONFIG_SEMIHOST=y
CONFIG_SEMIHOST_CONSOLE=y

# --- hard disable PM / idle sleep ---
CONFIG_PM=n
CONFIG_PM_DEVICE=n
CONFIG_PM_DEVICE_RUNTIME=n

# Optional: if you have tickless enabled somewhere
CONFIG_TICKLESS_KERNEL=n





# C++ support
CONFIG_CPP=y
CONFIG_STD_CPP17=y

# Use GNU libstdc++ instead of Zephyr minimal C++ library
CONFIG_REQUIRES_FULL_LIBCPP=y
CONFIG_GLIBCXX_LIBCPP=y

# Use newlib (since you're already using it / typical on STM32)
CONFIG_NEWLIB_LIBC=y

CONFIG_MAIN_STACK_SIZE=16384
CONFIG_SYSTEM_WORKQUEUE_STACK_SIZE=8192
CONFIG_HEAP_MEM_POOL_SIZE=0
```

## src/main.cpp
```c
#include <zephyr/kernel.h>
#include <zephyr/sys/printk.h>
#include <zephyr/drivers/gpio.h>
#include <inttypes.h>

#include "ADCSCore.hpp"
#include "adcs_platform.hpp"

struct LoopTimingStats {
    uint64_t cycle_count;
    uint64_t min_cycle_us;
    uint64_t max_cycle_us;
    uint64_t total_time_us;
    uint64_t window_start_ms;
};

static LoopTimingStats timing_stats = {
    .cycle_count = 0,
    .min_cycle_us = UINT64_MAX,
    .max_cycle_us = 0,
    .total_time_us = 0,
    .window_start_ms = 0,
};

#define LED_NODE DT_ALIAS(led0)
#if !DT_NODE_HAS_STATUS(LED_NODE, okay)
#error "led0 alias is not defined in the device tree"
#endif
static const struct gpio_dt_spec led0 = GPIO_DT_SPEC_GET(LED_NODE, gpios);

static void controlLoopOnce(ADCS::Core &adcs) {
    ADCS::SensorData sensors{};
    sensors.unix_time     = ADCSPlatform::getUnixTime();
    sensors.gyro          = ADCSPlatform::getGyroData();
    sensors.star_quat     = ADCSPlatform::getStarTrackerQuaternion();
    sensors.css_currents  = ADCSPlatform::getCoarseSunSensorCurrents();
    sensors.magnetometer  = ADCSPlatform::getMagnetometerData();
    sensors.gps_ecef      = ADCSPlatform::getGPSECEFData();
    sensors.wheel_speeds  = ADCSPlatform::getReactionWheelSpeeds();

    ADCS::Command cmd{};
    cmd.mode = ADCS::MissionMode::STANDBY;

    ADCS::AdcsOutput out = adcs.update(sensors, cmd);

    ADCSPlatform::sendWheelTorques(out.wheel_torque);
    ADCSPlatform::sendMTQDipoles(out.mtq_dipole);
}

extern "C" int main(void) {
    printk("ADCS Zephyr stub booting...\n");

    if (!gpio_is_ready_dt(&led0)) {
        printk("LED0 GPIO device is not ready\n");
        return 0;
    }
    if (gpio_pin_configure_dt(&led0, GPIO_OUTPUT_INACTIVE) < 0) {
        printk("Failed to configure LED0\n");
        return 0;
    }

    ADCS::Core adcs;

    timing_stats.window_start_ms = k_uptime_get();

    while (1) {
        uint64_t start_cyc = k_cycle_get_64();

        // optional marker pulse
        gpio_pin_toggle_dt(&led0);
        gpio_pin_toggle_dt(&led0);

        controlLoopOnce(adcs);

        uint64_t end_cyc = k_cycle_get_64();
        uint64_t cycle_us = k_cyc_to_us_near64(end_cyc - start_cyc);

        timing_stats.cycle_count++;
        timing_stats.total_time_us += cycle_us;
        if (cycle_us < timing_stats.min_cycle_us) timing_stats.min_cycle_us = cycle_us;
        if (cycle_us > timing_stats.max_cycle_us) timing_stats.max_cycle_us = cycle_us;

        uint64_t now_ms = k_uptime_get();
        uint64_t elapsed_ms = now_ms - timing_stats.window_start_ms;

        if (elapsed_ms >= 1000) {
            uint64_t avg_cycle_us = timing_stats.total_time_us / timing_stats.cycle_count;

            // frequency with 0.1 Hz resolution WITHOUT floats:
            // freq_x10 = count / (elapsed_s) * 10 = count * 10000 / elapsed_ms
            uint64_t freq_x10 = (timing_stats.cycle_count * 10000ULL) / elapsed_ms;

            printk("[ADCS LOOP] Count: %" PRIu64
                   " | Freq: %" PRIu64 ".%" PRIu64 " Hz"
                   " | Cycle - Min: %" PRIu64 " us, Max: %" PRIu64 " us, Avg: %" PRIu64 " us\n",
                   timing_stats.cycle_count,
                   (freq_x10 / 10), (freq_x10 % 10),
                   timing_stats.min_cycle_us, timing_stats.max_cycle_us, avg_cycle_us);

            // reset window
            timing_stats.cycle_count = 0;
            timing_stats.total_time_us = 0;
            timing_stats.min_cycle_us = UINT64_MAX;
            timing_stats.max_cycle_us = 0;
            timing_stats.window_start_ms = now_ms;
        }

        // if you want to cap loop rate, add a sleep here
        // k_msleep(1);
    }
}
```

## src/ADCSCore.cpp
```c
#include "ADCSCore.hpp"

namespace ADCS {

Core::Core()
    : observer_(), refgen_(), controller_()
{
}

AdcsOutput Core::update(const SensorData& sensors, const Command& cmd)
{
    // 1. Pack measurements for observer (Vector29)
    Param::Vector29 meas;
    meas.setSegment(0, Math::Vec<3>::Zero());  // accelerometer placeholder
    meas.setSegment(3, sensors.gyro);
    meas.setSegment(6, sensors.star_quat);
    meas.setSegment(10, sensors.css_currents);
    meas.setSegment(16, sensors.magnetometer);
    meas.setSegment(19, sensors.gps_ecef);
    meas.setSegment(25, sensors.wheel_speeds);

    // 2. Run observer
    Param::Vector17 states_hat = observer_.update(meas, sensors.unix_time);

    // 3. Run reference generator with command
    auto ref_out = refgen_.update(states_hat, cmd, sensors.unix_time);
    Param::Vector10 reference = ref_out.reference;
    Param::PointingMode internal_mode = ref_out.mode;

    // 4. Run controller
    auto ctrl_out = controller_.update(states_hat, reference, meas, internal_mode);

    // 5. Pack output
    AdcsOutput out;
    out.wheel_torque = ctrl_out.tau.segment<4>(0);
    out.mtq_dipole = ctrl_out.tau.segment<3>(4);
    out.attitude_est = states_hat.segment<4>(6);
    out.rate_est = states_hat.segment<3>(10);
    out.estimator_valid = !states_hat.hasNaN();
    out.current_mode = cmd.mode;  // Echo commanded mode

    // Adding equivalence variables, won't be here later 
    out.reference = reference; 
    out.states_m = ctrl_out.states_m;
    out.states_hat = states_hat;

    return out;
}

void Core::reset() {
    observer_ = ObserverClass();
    refgen_ = ReferenceGenerator();
    controller_ = ControllerManager();
}

} // namespace ADCS
```

## src/ADCSCore.hpp
```c
#ifndef ADCSCORE_HPP
#define ADCSCORE_HPP

#include <components/core_Observer.hpp>
#include <components/core_ReferenceGenerator.hpp>
#include <components/core_ControllerManager.hpp>

namespace ADCS {

// ============================================================================
// COMMAND INTERFACE (What CDH/Ground sends to ADCS)
// ============================================================================

// Mission-level modes (what operators command)
enum class MissionMode { 
    SAFE,       // Power down
    DETUMBLE,  // Detumble, minimal actuator use
    STANDBY,    // Sun-pointing for power generation
    DOWNLINK,   // Point antenna at ground station
    IMAGING,    // Point boresight at earth target
    CUSTOM      // Escape hatch for explicit vector control
};

// Ground target for geo-pointing modes
struct GroundTarget {
    double latitude;   // [deg] geodetic
    double longitude;  // [deg]
    double altitude;   // [m] above WGS84 ellipsoid (0 for ground stations)
};

// Command from CDH/Ground
struct Command {
    MissionMode mode;
    
    // Used for DOWNLINK, IMAGING modes
    GroundTarget target;
    
    // For IMAGING: true = track target location, false = point nadir
    bool track_target;
    
    // For CUSTOM mode only (escape hatch)
    Math::Vec<3> body_axis;
    Math::Vec<3> target_eci;
    
    // Helper: default constructor
    Command() : mode(MissionMode::SAFE), target{0,0,0}, track_target(false),
                body_axis{0,0,1}, target_eci{1,0,0} {}
};

// ============================================================================
// SENSOR INTERFACE (What CAN provides from sensors)
// ============================================================================
struct SensorData {
    double unix_time;          // From GPS or RTC
    Math::Vec<3> gyro;         // [rad/s] body rates
    Math::Vec<4> star_quat;    // [q0,q1,q2,q3] quaternion, scalar-first
    Math::Vec<6> css_currents; // [A] coarse sun sensor currents (6 faces)
    Math::Vec<3> magnetometer; // [T] magnetic field in body frame
    Math::Vec<6> gps_ecef;     // [m, m/s] position and velocity in ECEF
    Math::Vec<4> wheel_speeds; // [rad/s] reaction wheel angular velocities
};

// ============================================================================
// OUTPUT INTERFACE (What ADCS sends back via CAN)
// ============================================================================
struct AdcsOutput {
    Math::Vec<4> wheel_torque;
    Math::Vec<3> mtq_dipole;
    Math::Vec<4> attitude_est;
    Math::Vec<3> rate_est;
    bool estimator_valid;
    MissionMode current_mode;
    
    // Add these for logging equivalence. These won't be here later
    Param::Vector10 reference;   // Reference trajectory
    Param::Vector7 states_m;     // Model states from controller
    Param::Vector17 states_hat;  // Full estimated state
};

// ============================================================================
// CORE CLASS (The Black Box)
// ============================================================================
class Core {
public: 
    Core();
    
    AdcsOutput update(const SensorData& sensors, const Command& command);
    
    void reset();

private:
    ObserverClass observer_;
    ReferenceGenerator refgen_;
    ControllerManager controller_;
};

} // namespace ADCS

#endif // ADCSCORE_HPP
```

## src/Shared_Constants.hpp
```c
#ifndef SHARED_CONSTANTS_HPP
#define SHARED_CONSTANTS_HPP

// SHARED CONSTANTS
// Parameters that MUST be identical between Core (flight software) and Plant (sim)

namespace Shared {

    // Timing
    constexpr double Ts = 0.025;  // Sample period [s] - 40 Hz loop rate

    // Math constants
    constexpr double PI = 3.14159265358979323846;
    constexpr double deg2rad = PI / 180.0;
    constexpr double rad2deg = 180.0 / PI;
}

#endif // SHARED_CONSTANTS_HPP
```

## src/adcs_platform.hpp
```c
#pragma once

#include "ADCSCore.hpp"

namespace ADCSPlatform {

// Time: for now, seconds since boot (stored in unix_time field)
double getUnixTime();

// Sensor getters (stubbed)
Math::Vec<3> getGyroData();
Math::Vec<4> getStarTrackerQuaternion();     // scalar-first [q0,q1,q2,q3]
Math::Vec<6> getCoarseSunSensorCurrents();   // 6 faces
Math::Vec<3> getMagnetometerData();
Math::Vec<6> getGPSECEFData();               // [x y z vx vy vz] ECEF
Math::Vec<4> getReactionWheelSpeeds();

// Actuator senders (stubbed)
void sendWheelTorques(const Math::Vec<4>& wheel_torque);
void sendMTQDipoles(const Math::Vec<3>& mtq_dipole);

} // namespace ADCSPlatform
```

## src/adcs_platform_zephyr_stub.cpp
```c
#include <zephyr/kernel.h>
#include <zephyr/sys/printk.h>
#include "adcs_platform.hpp"

namespace {

// Small helper so you can printk any Vec<N> without iostream.
template<int N>
void printkVec(const char* label, const Math::Vec<N>& v) {
    printk("%s[", label);
    for (int i = 0; i < N; ++i) {
        printk("%f", v(i));
        if (i < N - 1) printk(", ");
    }
    printk("]\n");
}

} // namespace

namespace ADCSPlatform {

double getUnixTime() {
    // True UNIX time comes from GPS/RTC/CDH. Today: seconds since boot.
    return static_cast<double>(k_uptime_get()) * 1e-3;
}

Math::Vec<3> getGyroData() {
    // [rad/s] body rates
    return Math::Vec<3>{0.0, 0.0, 0.0};
}

Math::Vec<4> getStarTrackerQuaternion() {
    // scalar-first quaternion [q0,q1,q2,q3] = identity
    return Math::Vec<4>{1.0, 0.0, 0.0, 0.0};
}

Math::Vec<6> getCoarseSunSensorCurrents() {
    // [A] currents for 6 faces (arbitrary, but non-zero)
    return Math::Vec<6>{0.8, 0.2, 0.05, 0.0, 0.0, 0.1};
}

Math::Vec<3> getMagnetometerData() {
    // [T] rough Earth field magnitude scale
    return Math::Vec<3>{25e-6, -5e-6, 40e-6};
}

Math::Vec<6> getGPSECEFData() {
    // [m, m/s] x y z vx vy vz (totally fake)
    return Math::Vec<6>{1.0e6, 2.0e6, 3.0e6, 0.0, 7.5e3, 0.0};
}

Math::Vec<4> getReactionWheelSpeeds() {
    // [rad/s] 4 wheels
    return Math::Vec<4>{0.0, 0.0, 0.0, 0.0};
}

void sendWheelTorques(const Math::Vec<4>& t) {
    // printkVec<4>("RW torque cmd: ", t);
}

void sendMTQDipoles(const Math::Vec<3>& m) {
    // printkVec<3>("MTQ dipole cmd: ", m);
}

} // namespace ADCSPlatform
```
