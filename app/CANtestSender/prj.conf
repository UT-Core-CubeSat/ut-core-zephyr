## prj.conf
```kconfig
CONFIG_GPIO=y
CONFIG_CAN=y
CONFIG_CAN_STM32_FDCAN=y

# --- LOGGING & CONSOLE SETUP (RTT) ---
# 1. Force the Console subsystem to stay ON
CONFIG_CONSOLE=y
CONFIG_STDOUT_CONSOLE=y

# 2. Configure RTT as the backend
CONFIG_USE_SEGGER_RTT=y
CONFIG_RTT_CONSOLE=y

# 3. Disable UART/Serial to prevent conflicts
CONFIG_UART_CONSOLE=n
CONFIG_SERIAL=n

# 4. Connect Printk and Logging to RTT
CONFIG_PRINTK=y
CONFIG_LOG=y
CONFIG_LOG_BACKEND_RTT=y
CONFIG_LOG_BACKEND_UART=n
CONFIG_LOG_MODE_IMMEDIATE=y

# 5. Enable Semihosting for additional console output
CONFIG_SEMIHOST=y
CONFIG_SEMIHOST_CONSOLE=y

# Force non-byte memcpy behavior (avoid -Os style byte writes)
CONFIG_SPEED_OPTIMIZATIONS=y
CONFIG_SIZE_OPTIMIZATIONS=n
CONFIG_NO_OPTIMIZATIONS=n
```

## boards/nucleo_u5a5zj_q.overlay
```dts
/* app.overlay */

/ {
    /* (Optional) Defines for readability if needed, usually built-in */
};

/* 1. Configure PLL1 to take your 4MHz MSIS and boost it */
&pll1 {
    status = "okay";
    
    /* Input source: MSIS (4MHz per your setup) */
    clocks = <&clk_msis>;
    
    /* * PLL Calculation:
     * Input = 4 MHz
     * Div-M = 1  --> Ref = 4 MHz
     * Mul-N = 40 --> VCO = 160 MHz
     * Div-Q = 2  --> PLL1_Q Output = 80 MHz (Perfect for CAN)
     * Div-R = 2  --> PLL1_R Output = 80 MHz (Available for System if you want later)
     */
    div-m = <1>;
    mul-n = <40>;
    div-q = <2>;
    div-r = <2>;
    div-p = <2>;
};

/* 2. Configure FDCAN to use that new PLL1_Q clock */
&fdcan1 {
    status = "okay";
    
    /* * Line 1: Register Clock (APB1)
     * Line 2: Kernel Clock (The one we just fixed!). We select PLL1_Q (Value 1).
     */
    clocks = <&rcc STM32_CLOCK_BUS_APB1_2 0x00000200>,
             <&rcc STM32_SRC_PLL1_Q FDCAN1_SEL(1)>;

    /* Bus settings */
    bus-speed = <500000>;
    sample-point = <875>;
    bus-speed-data = <500000>;
    sample-point-data = <875>;

    /* Pin definitions (Make sure these match your board layout!) */
    pinctrl-0 = <&fdcan1_rx_pa11 &fdcan1_tx_pa12>;
    pinctrl-names = "default";
};

/* 3. Ensure the RCC knows to keep the Q output enabled */
&rcc {
    /* We add the PLL configuration here to ensure the clock subsystem handles it */
    clocks = <&clk_msis>;
    clock-frequency = <DT_FREQ_M(4)>; /* Keeps your system running safely at 4MHz */
};
```

## src/main.c
```c
#include <zephyr/kernel.h>
#include <zephyr/device.h>
#include <zephyr/sys/printk.h>
#include <zephyr/drivers/gpio.h>
#include <zephyr/drivers/can.h>

#define LED_TX_NODE   DT_ALIAS(led0)
#define CAN_NODE      DT_NODELABEL(fdcan1)
#define CAN_EN_NODE   DT_ALIAS(canen)
#define CAN_STB_NODE  DT_ALIAS(canstb)

static const struct gpio_dt_spec led_tx  = GPIO_DT_SPEC_GET(LED_TX_NODE, gpios);
static const struct gpio_dt_spec can_vio = GPIO_DT_SPEC_GET(CAN_EN_NODE, gpios);
static const struct gpio_dt_spec can_stb = GPIO_DT_SPEC_GET(CAN_STB_NODE, gpios);

static const struct device *const can_dev = DEVICE_DT_GET(CAN_NODE);

static void pulse_tx_led(int ms)
{
    gpio_pin_set_dt(&led_tx, 1);
    k_msleep(ms);
    gpio_pin_set_dt(&led_tx, 0);
}

static const char *state_str(enum can_state s)
{
    switch (s) {
    case CAN_STATE_ERROR_ACTIVE:  return "ERROR_ACTIVE";
    case CAN_STATE_ERROR_PASSIVE: return "ERROR_PASSIVE";
    case CAN_STATE_BUS_OFF:       return "BUS_OFF";
    case CAN_STATE_STOPPED:       return "STOPPED";
    default: return "UNKNOWN";
    }
}

int main(void)
{
    printk("\n=== CAN TX blink test ===\n");

    gpio_pin_configure_dt(&led_tx, GPIO_OUTPUT_INACTIVE);

    gpio_pin_configure_dt(&can_vio, GPIO_OUTPUT_INACTIVE);
    gpio_pin_configure_dt(&can_stb, GPIO_OUTPUT_INACTIVE);
    gpio_pin_set_dt(&can_vio, 1);
    k_msleep(5);
    gpio_pin_set_dt(&can_stb, 0);
    k_msleep(5);

    int ret = can_set_mode(can_dev, CAN_MODE_NORMAL);
    printk("can_set_mode=%d\n", ret);

    ret = can_start(can_dev);
    printk("can_start=%d\n", ret);

    struct can_frame frame = {
        .id = 0x123,
        .flags = 0,
        .dlc = 8,
        .data = { 1,2,3,4,5,6,7,0 }
    };

    uint8_t ctr = 0;

    while (1) {
        frame.data[7] = ctr++;

        ret = can_send(can_dev, &frame, K_MSEC(200), NULL, NULL);

        enum can_state st;
        struct can_bus_err_cnt ec;
        (void)can_get_state(can_dev, &st, &ec);

        printk("TX: ret=%d  state=%s  tx_err=%u  rx_err=%u\n",
               ret, state_str(st), ec.tx_err_cnt, ec.rx_err_cnt);

        if (ret == 0) {
            pulse_tx_led(30);
        } else {
            /* error: double blink */
            pulse_tx_led(20);
            k_msleep(50);
            pulse_tx_led(20);
        }

        k_msleep(300);
    }
}
```
