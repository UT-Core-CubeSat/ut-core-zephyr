## .west/west.yml
```yaml
manifest:
  self:
    path: .west
  remotes:
    - name: zephyrproject
      url-base: https://github.com/zephyrproject-rtos
  projects:
    - name: zephyr
      remote: zephyrproject
      revision: v4.4.0-rc3
      import:
        name-allowlist:
          - zephyr
          - cmsis_6
          - hal_stm32
          - segger
```

## apps/COMMS/drivers/rfm26w/Kconfig
```kconfig
# RFM26W (Si446x-class) radio driver

config RFM26W
	bool "RFM26W radio driver"
	default y
	depends on DT_HAS_HOPERF_RFM26W_ENABLED
	select SPI
	select GPIO
	help
	  Driver for the HopeRF RFM26W sub-GHz transceiver module. It moves fixed-size
	  blocks over the radio. See include/ut/drivers/rfm26w.h.

if RFM26W

config RFM26W_INIT_PRIORITY
	int "RFM26W init priority"
	default 80
	help
	  Device initialization priority. Must be later than the SPI and GPIO controllers.

config RFM26W_CTS_TIMEOUT_MS
	int "Clear-to-send timeout for ordinary commands (ms)"
	default 20
	range 1 1000
	help
	  How long the driver polls READ_CMD_BUFF for CTS (0xFF) after a command before it
	  gives up with -ETIMEDOUT. The datasheet's typical CTS time is 20 microseconds.

config RFM26W_POWER_UP_TIMEOUT_MS
	int "Clear-to-send timeout for POWER_UP (ms)"
	default 100
	range 1 5000
	help
	  POWER_UP can take longer to set CTS than other commands.

config RFM26W_STARTUP_DELAY_MS
	int "Wait after releasing SDN (ms)"
	default 20
	range 5 200
	help
	  Time to wait after SDN goes low before the first SPI command. The datasheet gives
	  4.5 ms for the power-on reset and 20 ms from shutdown to a ready radio (table 9).

config RFM26W_VERIFY_PROFILE
	bool "Read the radio profile back after loading it"
	default y
	help
	  After loading a profile table, read every property back with GET_PROPERTY and fail
	  start with -EIO on a mismatch.

config RFM26W_PA_LEVEL_MAX
	int "Highest PA_PWR_LVL the driver will write (0 to 127)"
	default 32
	range 0 127
	help
	  Safety cap on the raw PA level, applied after the dBm to level conversion. The
	  conversion in the driver is an UNMEASURED PLACEHOLDER (PLANNED.md open item 17), so
	  this cap, not the dBm value, is what keeps bench work at a low power. Raise it
	  only after the real output power has been measured.

config RFM26W_TX_THRESHOLD
	int "TX FIFO almost-empty threshold (bytes of free space)"
	default 48
	range 1 64
	help
	  The TX almost-empty interrupt fires when the TX FIFO has at least this many bytes
	  free, so (64 - threshold) bytes are left to send when the driver is asked to refill.
	  The default of 48 leaves 16 bytes: about 13 ms of slack at 9.6 kb/s, about 2.6 ms at
	  50 kb/s. The driver writes this itself after loading the profile.

config RFM26W_RX_THRESHOLD
	int "RX FIFO almost-full threshold (bytes present)"
	default 48
	range 1 64
	help
	  The RX almost-full interrupt fires when the RX FIFO holds at least this many bytes,
	  leaving (64 - threshold) bytes of room before overflow. Same timing as above. The
	  driver writes this itself after loading the profile.

config RFM26W_WORKQ_STACK_SIZE
	int "Stack size of the radio work queue thread"
	default 1536
	help
	  The radio has its own work queue thread that handles nIRQ (FIFO streaming) and runs
	  the receive callback. The callback runs on this stack.

config RFM26W_WORKQ_PRIORITY
	int "Priority of the radio work queue thread"
	default 1
	help
	  Zephyr thread priority (lower number is more urgent, negative is cooperative). FIFO
	  streaming has a deadline of a few milliseconds at the higher data rates, so this must
	  be at least as urgent as every application thread that could hold the CPU for longer
	  than that (PLANNED.md section 5.2).

module = RFM26W
module-str = RFM26W
source "subsys/logging/Kconfig.template.log_config"

endif # RFM26W
```

## apps/COMMS/drivers/rfm26w/dts/bindings/radio/hoperf,rfm26w.yaml
```yaml
description: |
  HopeRF RFM26W sub-GHz transceiver module (Si446x-class), connected over SPI.

  Example:

    &spi2 {
        rfm26w0: rfm26w@3 {
            compatible = "hoperf,rfm26w";
            reg = <3>;
            spi-max-frequency = <1000000>;
            int-gpios = <&gpioa 1 (GPIO_ACTIVE_LOW | GPIO_PULL_UP)>;
            sdn-gpios = <&gpioa 2 GPIO_ACTIVE_HIGH>;
            block-length = <223>;
            xo-frequency-hz = <30000000>;  /* ASSUMED, check the module, see below */
        };
    };

  The reference clock (xo-frequency-hz, xo-tcxo) is an ASSUMPTION. If it changes, the
  radio profile has to be regenerated (PLANNED.md section 5.4).

compatible: "hoperf,rfm26w"

include: spi-device.yaml

properties:
  int-gpios:
    type: phandle-array
    required: true
    description: |
      nIRQ output of the radio. Active low. GPIO_ACTIVE_LOW is required (checked at build
      time): the driver treats a logical 1 as "interrupt pending".

  sdn-gpios:
    type: phandle-array
    required: true
    description: |
      SDN shutdown input of the radio. High (active) shuts the radio down completely and
      loses its configuration. GPIO_ACTIVE_HIGH is required (checked at build time). The driver holds the radio in shutdown until it is started.

  tx-ant-gpios:
    type: phandle-array
    description: |
      TX-ANT antenna switch pin, if it is wired to the host instead of a radio GPIO.
      Driven opposite to rx-ant-gpios. Must be GPIO_ACTIVE_HIGH (the driver refuses to
      initialise otherwise).

  rx-ant-gpios:
    type: phandle-array
    description: |
      RX-ANT antenna switch pin, if it is wired to the host instead of a radio GPIO.
      Driven opposite to tx-ant-gpios. Must be GPIO_ACTIVE_HIGH (the driver refuses to
      initialise otherwise).

  block-length:
    type: int
    default: 223
    description: |
      Fixed block length in bytes, in both directions (the START_RX RX_LEN value). The chip's
      TX_LEN and RX_LEN fields are 16 bits, so at most 65535 (checked at build time).

  xo-frequency-hz:
    type: int
    default: 30000000
    description: |
      !!! ASSUMPTION, MALLEABLE, MAY NEED ADJUSTING !!!
      Frequency of the radio's reference clock (crystal, or TCXO if xo-tcxo is set), in Hz.
      The default is 30 MHz because that is the Si446x default and the RFM26W datasheet's
      "default crystal". It has NOT been confirmed for the module on the board. Change this
      value if the module uses something else (the chip accepts 25 to 32 MHz).

      This value is sent to the radio in POWER_UP and used to compute the carrier frequency.
      The generated radio profile (src/rfm26w_profiles.c) bakes in the same value, so if you
      change this property you MUST regenerate the profile. See PLANNED.md section 5.4,
      "Regenerating the radio profile". A wrong value gives a wrong carrier frequency, data
      rate and deviation, with no error from the chip.

  xo-tcxo:
    type: boolean
    description: |
      !!! ASSUMPTION, MALLEABLE, MAY NEED ADJUSTING !!!
      Set if the reference clock is a TCXO or an external clock signal instead of a crystal
      (the TCXO bit of POWER_UP XTAL_OPTIONS). Not set by default, because the module is
      assumed to use a crystal. Not confirmed for the module on the board.
```

## boards/arm/ut_core/board.yml
```yaml
board:
  name: ut_core
  full_name: UT-CORE STM32U5
  vendor: utah_tech
  socs:
    - name: stm32u5a5xx
```
