## prj.conf
```kconfig
CONFIG_RTC=y
CONFIG_RTC_STM32=y


# --- FLASH ---
CONFIG_FLASH=y
CONFIG_FLASH_MAP=y
CONFIG_MPU_ALLOW_FLASH_WRITE=y

# --- DMA / CACHE ---
CONFIG_DMA=n
CONFIG_SPI_STM32_DMA=n
CONFIG_CACHE_MANAGEMENT=y

# --- PERIPHERALS ---
CONFIG_GPIO=y
CONFIG_CAN=n
CONFIG_SPI=y
CONFIG_SPI_STM32=y
CONFIG_CAN_STM32_FDCAN=n

# --- CONSOLE (UART) ---
CONFIG_CONSOLE=y
CONFIG_STDOUT_CONSOLE=y
CONFIG_UART_CONSOLE=y
CONFIG_SERIAL=y

# --- RTT (disabled) ---
CONFIG_USE_SEGGER_RTT=n
CONFIG_RTT_CONSOLE=n

# --- PRINTK / LOGGING ---
CONFIG_PRINTK=y
CONFIG_LOG=y
CONFIG_LOG_BACKEND_RTT=n
CONFIG_LOG_BACKEND_UART=y
CONFIG_LOG_MODE_IMMEDIATE=y

# --- SEMIHOSTING (disabled) ---
CONFIG_SEMIHOST=n
CONFIG_SEMIHOST_CONSOLE=n

# --- POWER MANAGEMENT (disabled) ---
CONFIG_PM=n
CONFIG_PM_DEVICE=n
CONFIG_PM_DEVICE_RUNTIME=n
CONFIG_TICKLESS_KERNEL=n
```

## src/main.c
```c
#include <zephyr/kernel.h>
#include <zephyr/drivers/gpio.h>
#include <zephyr/logging/log.h>

LOG_MODULE_REGISTER(wdt_pulse, LOG_LEVEL_INF);

#define WDT_PULSE_PERIOD_MS 10

static const struct gpio_dt_spec wdtpin =
	GPIO_DT_SPEC_GET(DT_NODELABEL(wdtpin), gpios);

static void wdt_timer_handler(struct k_timer *timer)
{
	gpio_pin_set_dt(&wdtpin, 0);
	gpio_pin_set_dt(&wdtpin, 1);
}

K_TIMER_DEFINE(wdt_timer, wdt_timer_handler, NULL);

int main(void)
{
	if (!gpio_is_ready_dt(&wdtpin)) {
		LOG_ERR("WDT GPIO (PB2) not ready");
		return -1;
	}

	gpio_pin_configure_dt(&wdtpin, GPIO_OUTPUT_HIGH);

	k_timer_start(&wdt_timer, K_MSEC(WDT_PULSE_PERIOD_MS),
		       K_MSEC(WDT_PULSE_PERIOD_MS));

	LOG_INF("Watchdog pulse started: %d ms period on PB2",
		WDT_PULSE_PERIOD_MS);

	while (1) {
		k_sleep(K_FOREVER);
	}
}
```
