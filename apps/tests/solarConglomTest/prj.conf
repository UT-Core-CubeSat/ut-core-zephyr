## CMakeLists.txt
```
cmake_minimum_required(VERSION 3.20.0)

set(BOARD ut_core)

find_package(Zephyr REQUIRED HINTS $ENV{ZEPHYR_BASE})
project(solar_main)

target_sources(app PRIVATE src/main.c)
#target_sources(app PRIVATE src/main.c)
# target_include_directories(app PRIVATE ${ROOT}/core)
target_include_directories(app PRIVATE $ENV{ROOT})
```

## prj.conf
```kconfig
CONFIG_GPIO=y
CONFIG_CAN=y
CONFIG_CAN_STM32_FDCAN=y

# --- LOGGING & CONSOLE SETUP (RTT) ---
# 1. Force the Console subsystem to stay ON
CONFIG_CONSOLE=y
CONFIG_STDOUT_CONSOLE=y

# 2. Configure RTT as the backend
CONFIG_USE_SEGGER_RTT=y
CONFIG_RTT_CONSOLE=y

# 3. Disable UART/Serial to prevent conflicts
CONFIG_UART_CONSOLE=n
CONFIG_SERIAL=n

# 4. Connect Printk and Logging to RTT
CONFIG_PRINTK=y
CONFIG_LOG=y
CONFIG_LOG_BACKEND_RTT=y
CONFIG_LOG_BACKEND_UART=n
CONFIG_LOG_MODE_IMMEDIATE=y

# CONFIG_NEWLIB_LIBC=y
# CONFIG_NEWLIB_LIBC_FLOAT_PRINTF=y
CONFIG_PICOLIBC_IO_FLOAT=y

CONFIG_PWM=y
```

## src/main.c
```c
/**
 * @file main.c
 * @brief Bench PWM validation tool for the Solar Conglomerate (magnetorquer)
 *        board's 4 coil-drive channels.
 *
 * Drives all 4 magnetorquer PWM outputs (TIM1_CH4N on PC5, TIM3_CH1/CH2/CH4
 * on PC6/PA7/PC9) to the same duty cycle simultaneously, sweeping 0-100%
 * and back in 5% steps for oscilloscope verification. Not flight firmware
 * — no CAN, no per-face control, just a raw hardware bring-up check.
 */


#include <zephyr/kernel.h>
#include <zephyr/device.h>
#include <zephyr/devicetree.h>
#include <zephyr/drivers/gpio.h>
#include <zephyr/drivers/pwm.h>
#include <zephyr/sys/printk.h>

#include <stm32_ll_tim.h>

/* Mux enable */
static const struct device *const gpioa = DEVICE_DT_GET(DT_NODELABEL(gpioa));

/* PWM devices */
static const struct device *const pwm1_dev = DEVICE_DT_GET(DT_NODELABEL(pwm1));
static const struct device *const pwm3_dev = DEVICE_DT_GET(DT_NODELABEL(pwm3));

#define PWM_FREQ    20000U
#define PWM_PERIOD  PWM_HZ(PWM_FREQ)

/* Channel numbers */
#define TIM1_CH4    4U
#define TIM3_CH1    1U
#define TIM3_CH2    2U
#define TIM3_CH4    4U

/**
 * @brief Enable TIM1's complementary CH4N output and set the timer's
 *        master output enable bit.
 *
 * PC5 is driven via TIM1's complementary channel output, which requires
 * CC4NE/CC4E in CCER and MOE in BDTR to be set or the pin stays gated
 * off regardless of what pwm_set() configures — Zephyr's PWM API does
 * not expose these bits directly, hence the raw register access.
 */
static void tim1_enable_ch4n(void)
{
    TIM1->CCER |= TIM_CCER_CC4NE | TIM_CCER_CC4E;
    TIM1->BDTR |= TIM_BDTR_MOE;
}

/**
 * @brief Set all 4 magnetorquer PWM channels to the same duty cycle.
 * @param duty_percent Duty cycle, 0-100.
 *
 * PC5 (TIM1_CH4N) is electrically inverted relative to the other three
 * channels, so its pulse value is computed as (PWM_PERIOD - pulse_tim)
 * to keep it tracking the same logical duty cycle as PC6/PA7/PC9.
 */
static void set_all_duty(uint32_t duty_percent)
{
    uint32_t pulse_tim = ((uint64_t)PWM_PERIOD * duty_percent) / 100U;
    uint32_t pulse_inv = PWM_PERIOD - pulse_tim;  /* inverted for CH4N */

    /* PC5: TIM1_CH4N — complementary, so invert */
    pwm_set(pwm1_dev, TIM1_CH4, PWM_PERIOD, pulse_inv, PWM_POLARITY_NORMAL);
    TIM1->CCER |= TIM_CCER_CC4NE | TIM_CCER_CC4E;
    TIM1->BDTR |= TIM_BDTR_MOE;

    /* PC6: TIM3_CH1 */
    pwm_set(pwm3_dev, TIM3_CH1, PWM_PERIOD, pulse_tim, PWM_POLARITY_NORMAL);

    /* PA7: TIM3_CH2 */
    pwm_set(pwm3_dev, TIM3_CH2, PWM_PERIOD, pulse_tim, PWM_POLARITY_NORMAL);

    /* PC9: TIM3_CH4 */
    pwm_set(pwm3_dev, TIM3_CH4, PWM_PERIOD, pulse_tim, PWM_POLARITY_NORMAL);
}

/**
 * @brief Entry point: verifies PWM/GPIO hardware, sets all 4 channels to
 *        50% for a scope check, then sweeps duty 0→100→0% indefinitely.
 *
 * Boot sequence: configure PA5 (mux enable) low, verify TIM1/TIM3 PWM
 * devices are ready, set all 4 channels to 50% duty (printing per-channel
 * pass/fail), wait 5 s, then loop forever sweeping duty in 5% steps every
 * 8 seconds, first ascending 0→100% then descending back to 0%.
 *
 * @note A commented-out block configures PC2/PC3/PC4 as inactive GPIO
 *       outputs — looks like an earlier or alternate mux/enable
 *       approach that was abandoned or is still under investigation,
 *       left in as dead code rather than removed.
 *
 * @return 0 if GPIOA, TIM1 PWM, or TIM3 PWM device isn't ready; otherwise
 *         does not return (infinite sweep loop).
 */
int main(void)
{
    int ret;

    printk("\n=== Solarconglomerator PWM Test (4 channels) ===\n");

    /* PA5: mux enable */
    if (!device_is_ready(gpioa)) {
        printk("ERROR: GPIOA not ready!\n");
        return 0;
    }
    gpio_pin_configure(gpioa, 5, GPIO_OUTPUT_ACTIVE);
    gpio_pin_set(gpioa, 5, 0);
    printk("PA5: mux enable LOW\n");

    // const struct device *const gpioc = DEVICE_DT_GET(DT_NODELABEL(gpioc));
    // gpio_pin_configure(gpioc, 2, GPIO_OUTPUT_INACTIVE);
    // gpio_pin_configure(gpioc, 3, GPIO_OUTPUT_INACTIVE);
    // gpio_pin_configure(gpioc, 4, GPIO_OUTPUT_INACTIVE);
    // gpio_pin_set(gpioc, 2, 0);
    // gpio_pin_set(gpioc, 3, 0);
    // gpio_pin_set(gpioc, 4, 0);

    /* Check devices */
    if (!device_is_ready(pwm1_dev)) {
        printk("ERROR: TIM1 PWM not ready!\n");
        return 0;
    }
    if (!device_is_ready(pwm3_dev)) {
        printk("ERROR: TIM3 PWM not ready!\n");
        return 0;
    }

    /* --- Set all channels to 50% --- */
    uint32_t half = PWM_PERIOD / 2;

    /* PC5: TIM1_CH4N */
    ret = pwm_set(pwm1_dev, TIM1_CH4, PWM_PERIOD, half, PWM_POLARITY_NORMAL);
    tim1_enable_ch4n();
    printk("PC5 TIM1_CH4N: %s\n", ret ? "FAIL" : "OK");

    /* PC6: TIM3_CH1 */
    ret = pwm_set(pwm3_dev, TIM3_CH1, PWM_PERIOD, half, PWM_POLARITY_NORMAL);
    printk("PC6 TIM3_CH1:  %s\n", ret ? "FAIL" : "OK");

    /* PA7: TIM3_CH2 */
    ret = pwm_set(pwm3_dev, TIM3_CH2, PWM_PERIOD, half, PWM_POLARITY_NORMAL);
    printk("PA7 TIM3_CH2:  %s\n", ret ? "FAIL" : "OK");

    /* PC9: TIM3_CH4 */
    ret = pwm_set(pwm3_dev, TIM3_CH4, PWM_PERIOD, half, PWM_POLARITY_NORMAL);
    printk("PC9 TIM3_CH4:  %s\n", ret ? "FAIL" : "OK");

    printk("\nAll channels at 50%% -- verify with scope.\n");
    printk("Sweep starts in 5 s ...\n\n");
    k_msleep(5000);

    /* Sweep all channels together */
    while (1) {
        for (int duty = 0; duty <= 100; duty += 5) {
            set_all_duty(duty);
            printk("duty=%3d%%\n", duty);
            k_msleep(8000);
        }

        for (int duty = 100; duty >= 0; duty -= 5) {
            set_all_duty(duty);
            printk("duty=%3d%%\n", duty);
            k_msleep(8000);
        }
    }
    return 0;
}
```

## src/board_config.h
```c
/**
 * @file board_config.h
 * @brief Solar Conglomerate (Magnetorquer Controller) board pin and
 *        parameter definitions.
 *
 * Defines the board's CAN node identity, TCAN3403 transceiver pins,
 * magnetorquer coil pin mapping (PC2-PC5, PWM where a timer AF is
 * available, GPIO-only otherwise), watchdog and MCU role-select pins,
 * default PWM frequency, and actuation safety limits (max on-time, max
 * duty cycle).
 *
 * Pin assignments:
 *   PC2  (pin  8) — MTQ channel 0 (PWM or GPIO)
 *   PC3  (pin  9) — MTQ channel 1
 *   PC4  (pin 10) — MTQ channel 2
 *   PC5  (pin 11) — MTQ channel 3
 *
 *   PA9  — TCAN3403 SILENT (active high = silent mode)
 *   PA10 — TCAN3403 SHDN   (active high = shutdown)
 *   PA11 — FDCAN1 RX
 *   PA12 — FDCAN1 TX
 *
 *   PA6  — MCU role select strap
 *   PA2  — Hardware watchdog kick (active edge TBD)
 */

#ifndef BOARD_CONFIG_H
#define BOARD_CONFIG_H

/* ================= NODE IDENTITY ================= */
/**
 * CAN bus node ID for the Solar Conglomerate board.
 * Must match the value used in can_proto.h / the CDH node table.
 */
#define BOARD_NODE_ID       0x08   /**< SOLAR_ID */
#define BOARD_NODE_NAME     "SOLAR"

/* ================= MAGNETORQUER PIN MAP ================= */
/*
 * PC2-PC5 drive the magnetorquer coils.  When PWM timer channels are
 * available these pins are muxed to the timer; otherwise they are used
 * as plain GPIO outputs for on/off control.
 *
 * Channel index | GPIO port | Pin | Package pin | Timer AF (if PWM)
 * --------------|-----------|-----|-------------|-------------------
 *       0       |   GPIOC   |  2  |      8      | TIM3_CH3 (AF2)  *
 *       1       |   GPIOC   |  3  |      9      | TIM3_CH4 (AF2)  *
 *       2       |   GPIOC   |  4  |     10      | — (GPIO only)   *
 *       3       |   GPIOC   |  5  |     11      | — (GPIO only)   *
 *
 * (*) TIM3_CH3/CH4 are available on PC2/PC3 via AF2 on STM32U5A5.
 *     PC4/PC5 do not have a general-purpose timer AF, so they are
 *     always GPIO-driven.  If true PWM is needed on all four channels,
 *     consider re-routing to pins with TIM4/TIM5 AF support.
 *
 * The DTS overlay enables the PWM channels that are available;
 * main.c auto-detects PWM vs GPIO at compile time.
 */
#define MTQ0_PORT       gpioc
#define MTQ0_PIN        2
#define MTQ1_PORT       gpioc
#define MTQ1_PIN        3
#define MTQ2_PORT       gpioc
#define MTQ2_PIN        4
#define MTQ3_PORT       gpioc
#define MTQ3_PIN        5

/* Package pin numbers (for schematic cross-reference only) */
#define MTQ0_PKG_PIN    8
#define MTQ1_PKG_PIN    9
#define MTQ2_PKG_PIN    10
#define MTQ3_PKG_PIN    11

/* ================= WATCHDOG ================= */
#define WATCHDOG_GPIO_PORT  gpioa
#define WATCHDOG_GPIO_PIN   2      /**< PA2 — external WD IC kick */

/* ================= MCU SELECT ================= */
#define MCU_SELECT_PORT     gpioa
#define MCU_SELECT_PIN      6      /**< PA6 — role strap */

/* ================= PWM PARAMETERS ================= */
/*
 * Default PWM frequency for magnetorquer drive.
 * 20 kHz is above audible range and keeps core losses low in the coils.
 * Period = 1 / 20 kHz = 50 µs = 50000 ns.
 *
 * This value is set in the DTS overlay (pwms property period field).
 * Defined here for reference and for any runtime reconfiguration logic.
 */
#define MTQ_PWM_FREQ_HZ         20000
#define MTQ_PWM_PERIOD_NS       (1000000000UL / MTQ_PWM_FREQ_HZ)  /* 50000 ns */

/* ================= SAFETY LIMITS ================= */
/*
 * Maximum single actuation duration.  Protects against a stuck-on
 * coil draining the battery if the timer command is corrupt.
 */
#define MTQ_MAX_ON_TIME_MS      60000   /**< 60 seconds */

/*
 * Maximum allowed duty cycle.  Depending on coil thermal design
 * this may need to be < 100% to prevent overheating.
 * Set to 100 during initial testing; tighten after thermal characterisation.
 */
#define MTQ_MAX_DUTY_PCT        100

#endif /* BOARD_CONFIG_H */
```

## src/demo.c
```c
// demo.c
#include <zephyr/kernel.h>
#include <zephyr/device.h>
#include <zephyr/devicetree.h>
#include <zephyr/drivers/gpio.h>
#include <zephyr/drivers/pwm.h>
#include <zephyr/drivers/can.h>
#include <zephyr/sys/printk.h>
#include <zephyr/logging/log.h>
#include <string.h>
#include "common/can_proto.h"
#include "common/temp_telemetry.h"

#include <stm32_ll_tim.h>

LOG_MODULE_REGISTER(solarcon, LOG_LEVEL_INF);

/* ===================================================== */
/* ================= CAN PROTOCOL ====================== */
/* ===================================================== */

/* Node IDs — match your bus allocation */
#define NODE_ID         0x08    /* Solar Conglomerator */
#define NODE_CDH        0x01
#define NODE_ADCS       0x04

/* Priority levels */
#define PRIO_HIGH  0
#define PRIO_MED   2
#define PRIO_LOW   4

/* can_packet_t is the shared type from common/can_proto.h. */

/* ===================================================== */
/* ================= HW DEVICES ======================== */
/* ===================================================== */

static const struct device *const gpioa   = DEVICE_DT_GET(DT_NODELABEL(gpioa));
static const struct device *const pwm1_dev = DEVICE_DT_GET(DT_NODELABEL(pwm1));
static const struct device *const pwm3_dev = DEVICE_DT_GET(DT_NODELABEL(pwm3));
static const struct device *const can_dev  = DEVICE_DT_GET(DT_NODELABEL(fdcan1));
static const struct device *i2c_bus = DEVICE_DT_GET(DT_NODELABEL(i2c1));

#define PWM_FREQ    20000U
#define PWM_PERIOD  PWM_HZ(PWM_FREQ)

#define TIM1_CH4    4U
#define TIM3_CH1    1U
#define TIM3_CH2    2U
#define TIM3_CH4    4U

/* CAN RX queue */
CAN_MSGQ_DEFINE(rxq, 16);

/* Shared state — current duty for telemetry reporting */
static volatile uint32_t current_duty_percent = 50;
static volatile uint32_t face_duty_percent[4] = {50, 50, 50, 50};

enum mtq_face_idx {
    MTQ_FACE_X_POS = 0,
    MTQ_FACE_X_NEG = 1,
    MTQ_FACE_Y_POS = 2,
    MTQ_FACE_Y_NEG = 3,
};

/* ===================================================== */
/* ================= PWM HELPERS ======================= */
/* ===================================================== */

static void tim1_enable_ch4n(void)
{
    TIM1->CCER |= TIM_CCER_CC4NE | TIM_CCER_CC4E;
    TIM1->BDTR |= TIM_BDTR_MOE;
}

static void set_face_pwm(uint32_t duty_x_pos, uint32_t duty_x_neg, uint32_t duty_y_pos, uint32_t duty_y_neg) {
    if (duty_x_pos > 100) 
        duty_x_pos = 100;
    if (duty_x_neg > 100) 
        duty_x_neg = 100;
    if (duty_y_pos > 100) 
        duty_y_pos = 100;
    if (duty_y_neg > 100) 
        duty_y_neg = 100;

    /* NOTE: edit this mapping later when final pin/face assignment is known. */
    uint32_t duty_by_face[4] = {
        duty_x_pos, duty_x_neg, duty_y_pos, duty_y_neg
    };

    uint32_t pulse_x_pos = ((uint64_t)PWM_PERIOD * duty_by_face[MTQ_FACE_X_POS]) / 100U;
    uint32_t pulse_x_neg = ((uint64_t)PWM_PERIOD * duty_by_face[MTQ_FACE_X_NEG]) / 100U;
    uint32_t pulse_y_pos = ((uint64_t)PWM_PERIOD * duty_by_face[MTQ_FACE_Y_POS]) / 100U;
    uint32_t pulse_y_neg = ((uint64_t)PWM_PERIOD * duty_by_face[MTQ_FACE_Y_NEG]) / 100U;
    uint32_t pulse_y_neg_tim1 = PWM_PERIOD - pulse_y_neg;

    /* Verified mapping from scope tests:
     *   TIM3_CH2 -> +X
     *   TIM3_CH1 -> -X
     *   TIM3_CH4 -> +Y
     *   TIM1_CH4 -> -Y
     */
    /* TIM1 CH4 path is electrically inverted on this board path. */
    pwm_set(pwm1_dev, TIM1_CH4, PWM_PERIOD, pulse_y_neg_tim1, PWM_POLARITY_NORMAL);
    TIM1->CCER |= TIM_CCER_CC4NE | TIM_CCER_CC4E;
    TIM1->BDTR |= TIM_BDTR_MOE;
    pwm_set(pwm3_dev, TIM3_CH1, PWM_PERIOD, pulse_x_neg, PWM_POLARITY_NORMAL);
    pwm_set(pwm3_dev, TIM3_CH2, PWM_PERIOD, pulse_x_pos, PWM_POLARITY_NORMAL);
    pwm_set(pwm3_dev, TIM3_CH4, PWM_PERIOD, pulse_y_pos, PWM_POLARITY_NORMAL);

    face_duty_percent[MTQ_FACE_X_POS] = duty_by_face[MTQ_FACE_X_POS];
    face_duty_percent[MTQ_FACE_X_NEG] = duty_by_face[MTQ_FACE_X_NEG];
    face_duty_percent[MTQ_FACE_Y_POS] = duty_by_face[MTQ_FACE_Y_POS];
    face_duty_percent[MTQ_FACE_Y_NEG] = duty_by_face[MTQ_FACE_Y_NEG];

    uint32_t max_duty = duty_by_face[MTQ_FACE_X_POS];
    if (duty_by_face[MTQ_FACE_X_NEG] > max_duty) max_duty = duty_by_face[MTQ_FACE_X_NEG];
    if (duty_by_face[MTQ_FACE_Y_POS] > max_duty) max_duty = duty_by_face[MTQ_FACE_Y_POS];
    if (duty_by_face[MTQ_FACE_Y_NEG] > max_duty) max_duty = duty_by_face[MTQ_FACE_Y_NEG];
    current_duty_percent = max_duty;
}

/* ===================================================== */
/* =========== MAGNETIC DIPOLE → PWM STUB ============== */
/* ===================================================== */

static inline int16_t unpack_be16(uint8_t msb, uint8_t lsb)
{
    return (int16_t)(((uint16_t)msb << 8) | (uint16_t)lsb);
}

/* ===================================================== */
/* ================= CAN TX ============================ */
/* ===================================================== */

/*
 * send_heartbeat() - Periodic heartbeat to CDH.
 * data[0] = 0 (no mode payload).
 */
static void send_heartbeat(void)
{
    int err = can_send2(can_dev, NODE_ID, CAN_BROADCAST, OP_HEARTBEAT, PRIO_LOW, 0, 0);
    if (err) {
        LOG_WRN("Failed to send OP_HEARTBEAT: %d", err);
    }
    LOG_DBG("TX heartbeat");
}

/*
 * send_soh() - State-of-health telemetry to CDH.
 *
 * Payload layout:
 *   [0] current duty %
 *   [1] temp sensor 1  (placeholder — raw ADC / 2 or °C)
 *   [2] temp sensor 2
 *   [3] temp sensor 3
 *   [4] temp sensor 4
 *   [5] status flags
 *   [6..7] reserved (0)
 * Opcode: OP_SOH_SOLAR (carried in the CAN ID).
 *
 * TODO: wire in real temp sensor reads.
 */
static void send_soh(void)
{
    uint8_t duty = (uint8_t)current_duty_percent;

    /* Read all temp sensors */
    struct temp_telemetry telem;
    int ok = temp_telemetry_read_all(i2c_bus, &telem);

    /* Pack first 4 sensor temps as rounded integer °C into payload.
     * Clamp to int8_t range (-128..127) since each slot is one byte. */
    uint8_t temps[4] = {0};
    for (int i = 0; i < 4 && i < NUM_TEMP_SENSORS; i++) {
        if (telem.s[i].status == 0) {
            int32_t c = (telem.s[i].temp_q4 + 8) / 16;
            if (c > 127) c = 127;
            if (c < -128) c = -128;
            temps[i] = (uint8_t)(int8_t)c;
        }
    }

    can_send8(can_dev, NODE_ID, NODE_CDH, OP_SOH_SOLAR, PRIO_LOW,
        duty,
        temps[0], temps[1], temps[2], temps[3],
        0x00,           /* status flags */
        0x00, 0x00
    );

    /* Print to console */
    LOG_INF("TX SOH  duty=%u%%  temps: %d/%d ok", duty, ok, NUM_TEMP_SENSORS);
    temp_telemetry_print(&telem);
}
/* ===================================================== */
/* ================= CAN RX ============================ */
/* ===================================================== */

static void handle_command(const can_packet_t *pkt)
{
    switch (pkt->op) {
    case OP_SET_MAG_DIPOLE: {
        /* ADCS packs mx/my/mz in data[0..5] (big-endian int16). */
        int16_t mx = unpack_be16(pkt->data[0], pkt->data[1]);
        int16_t my = unpack_be16(pkt->data[2], pkt->data[3]);
        int16_t mz = unpack_be16(pkt->data[4], pkt->data[5]);

        /* Sign-based face selection:
         *   +X -> x_pos=100, x_neg=0
         *   -X -> x_pos=0,   x_neg=100
         *   +Y -> y_pos=100, y_neg=0
         *   -Y -> y_pos=0,   y_neg=100
         *    0 -> both faces for that axis off
         * Z currently ignored (no Z torquers on this board revision).
         */
        const uint32_t x_pos = (mx > 0) ? 100U : 0U;
        const uint32_t x_neg = (mx < 0) ? 100U : 0U;
        const uint32_t y_pos = (my > 0) ? 100U : 0U;
        const uint32_t y_neg = (my < 0) ? 100U : 0U;
        set_face_pwm(x_pos, x_neg, y_pos, y_neg);

        LOG_INF("RX setMagDipoleMoment: mx=%d my=%d mz=%d -> X+/X-/Y+/Y- = %u/%u/%u/%u",
                mx, my, mz, x_pos, x_neg, y_pos, y_neg);

        /* ACK back to sender */
        int err = can_send2(can_dev, NODE_ID, pkt->src, OP_RESP_SET_MAG_DIPOLE, PRIO_LOW, (uint8_t)current_duty_percent, 0);
        if (err) {
            LOG_WRN("Failed to send OP_RESP_SET_MAG_DIPOLE: %d", err);
        }
        break;
    }
    default:
        LOG_WRN("Unknown command opcode: 0x%03X", pkt->op);
        break;
    }
}

static void handle_heartbeat(const can_packet_t *pkt)
{
    LOG_INF("RX heartbeat from 0x%02X", pkt->src);
}

static void can_dispatch(const can_packet_t *pkt)
{
    switch (pkt->op) {
    case OP_HEARTBEAT:       handle_heartbeat(pkt);  break;
    case OP_SET_MAG_DIPOLE:  handle_command(pkt);    break;
    default:
        LOG_WRN("Unhandled op: 0x%03X from 0x%02X", pkt->op, pkt->src);
        break;
    }
}

/* ===================================================== */
/* ================= CAN SETUP ========================= */
/* ===================================================== */

/* ===================================================== */
/* ================= CAN RX THREAD ===================== */
/* ===================================================== */

#define CAN_RX_STACK_SIZE  1024
#define CAN_RX_PRIORITY    5

static void can_rx_thread(void *a, void *b, void *c)
{
    struct can_frame frame;
    can_packet_t pkt;

    while (1) {
        if (k_msgq_get(&rxq, &frame, K_FOREVER) == 0) {
            if (can_decode(&frame, &pkt) != 0) {
                continue;
            }
            can_dispatch(&pkt);
        }
    }
}

K_THREAD_DEFINE(can_rx_tid, CAN_RX_STACK_SIZE,
    can_rx_thread, NULL, NULL, NULL,
    CAN_RX_PRIORITY, 0, 0);

/* ===================================================== */
/* ================= MAIN ============================== */
/* ===================================================== */

/* Telemetry / heartbeat intervals */
#define HEARTBEAT_INTERVAL_MS   1000
#define SOH_INTERVAL_MS         5000

int main(void)
{
    int ret;

    printk("\n=== Solarconglomerator PWM + CAN ===\n");

    /* PA5: mux enable */
    if (!device_is_ready(gpioa)) {
        printk("ERROR: GPIOA not ready!\n");
        return 0;
    }

    if (!device_is_ready(i2c_bus)) {
    LOG_ERR("I2C bus not ready — SOH temps will fail");
    }

    gpio_pin_configure(gpioa, 5, GPIO_OUTPUT_ACTIVE);
    gpio_pin_set(gpioa, 5, 0);

    /* PWM devices */
    if (!device_is_ready(pwm1_dev)) { LOG_ERR("TIM1 not ready"); return 0; }
    if (!device_is_ready(pwm3_dev)) { LOG_ERR("TIM3 not ready"); return 0; }

    /* Initial OFF on all MTQ channels. */
    uint32_t zero = 0;

    ret = pwm_set(pwm1_dev, TIM1_CH4, PWM_PERIOD, zero, PWM_POLARITY_NORMAL);
    tim1_enable_ch4n();
    LOG_INF("PC5 TIM1_CH4N: %s", ret ? "FAIL" : "OK");

    ret = pwm_set(pwm3_dev, TIM3_CH1, PWM_PERIOD, zero, PWM_POLARITY_NORMAL);
    LOG_INF("PC6 TIM3_CH1:  %s", ret ? "FAIL" : "OK");

    ret = pwm_set(pwm3_dev, TIM3_CH2, PWM_PERIOD, zero, PWM_POLARITY_NORMAL);
    LOG_INF("PA7 TIM3_CH2:  %s", ret ? "FAIL" : "OK");

    ret = pwm_set(pwm3_dev, TIM3_CH4, PWM_PERIOD, zero, PWM_POLARITY_NORMAL);
    LOG_INF("PC9 TIM3_CH4:  %s", ret ? "FAIL" : "OK");

    current_duty_percent = 0;
    face_duty_percent[MTQ_FACE_X_POS] = 0;
    face_duty_percent[MTQ_FACE_X_NEG] = 0;
    face_duty_percent[MTQ_FACE_Y_POS] = 0;
    face_duty_percent[MTQ_FACE_Y_NEG] = 0;

    /* CAN bus init */
    int err = tcan3403_wakeup();
    if (err) {
        LOG_ERR("TCAN3403 wakeup failed: %d", err);
    }
    err = can_setup(can_dev, NODE_ID, &rxq, NULL);
    if (err) {
        LOG_ERR("CAN Setup failed: %d", err);
        return;
    }

    LOG_INF("Running — MTQ outputs OFF, waiting for CAN commands");

    /* Main loop: heartbeat + SOH telemetry */
    int64_t last_hb  = k_uptime_get();
    int64_t last_soh = k_uptime_get();

    while (1) {
        int64_t now = k_uptime_get();

        if ((now - last_hb) >= HEARTBEAT_INTERVAL_MS) {
            send_heartbeat();
            last_hb = now;
        }

        if ((now - last_soh) >= SOH_INTERVAL_MS) {
            send_soh();
            last_soh = now;
        }

        k_msleep(100);
    }

    return 0;
}
```
